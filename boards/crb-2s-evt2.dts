/dts-v1/;

/include/ "crb-2s-common.dtsi"

/ {
cavium,bdk {
	/* This specifies a watchdog timer should run during boot and reset
	the chip if boot hangs for some reason. The timeout is specified
	in milliseconds. Zero disables the watchdog. */
	WATCHDOG-TIMEOUT = "10000";

	/* Force CCPI lane reversal. This should be set for boards which
	reverse the CCPI lanes between nodes. If lane 0 connects to lane
	23, this option is needed. CN88XX pass 2.0 and higher automatically
	detect lane reversal, so setting this is optional.
	    0 = Automatically detect lane reversal, no lane reversal on
	        CN88XX pass 1.x.
	    1 = Force lane reversal, required on CN88XX pass 1.0 with CCPI
	        lanes reversed. */
	CCPI-LANE-REVERSE = "1";

	/* The 100Mhz reference clock was only supported on the EVT4 and later
	designs. Override the setting of DDR-ALT-REFCLK for the EVT2 and EVT3 */
	DDR-ALT-REFCLK = "0";

	/* Run a short DRAM test after DRAM is initialized as quick check
	for functionality. This is normally not needed required. Boards
	with poor DRAM power supplies may use this to detect failures
	during boot. This should be used in combination with the watchdog
	timer. */
	DDR-TEST-BOOT = "1";

	/* The boot stage to be loaded after init.bin has run. */
	BDK-CONFIG-BOOT-NEXT-STAGE-INIT = "/fatfs/cortina-app.bin";
};
};

