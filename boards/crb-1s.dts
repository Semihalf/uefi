/dts-v1/;

/ {
cavium,bdk {
	/* THUNDERX TWSI port connected to the BMC for IPMI traffic.
	-1 = No connection exists. 0+ is TWSI bus number. */
	BMC-TWSI = "5";

        /* Allow a sequence of TWSI writes to be performed during boot. Each
        string in the list line is executed in sequence. The TWSI write
        format is:
            node,twsi_id,dev_addr,internal_addr,num_bytes,ia_width_bytes,data
            sleep,ms
        node           = ThunderX node ID the twsi bus is on. -1 means the local node
        twsi_id        = ThunderX twsi bus to use
        dev_addr       = TWSI bus address
        internal_addr  = TWSI internal address, zero if not used
        num_bytes      = Number of bytes to write (1-8)
        ia_width_bytes = Internal address width in bytes (0-2)
        data           = Data to write as a 64bit number
        sleep,ms       = This on a line delays for 'ms' milliseconds */
	TWSI-WRITE =
		/* Initialize IO expander U29 to set SFP_TX_DISABLE_0=0 and SFP_TX_DISABLE_1=0
		Set all pins as inputs except:
		    Pin 0.4: QSFP_RST_N
		    Pin 0.5: QSFP_MODSEL_N
		    Pin 0.6: QSFP_LPMODE
		    Pin 1.3: SFP_TX_DISABLE_0
		    Pin 1.7: SFP_TX_DISABLE_1
		    Data high means pin is input */
		"-1,0,0x20,0x6,1,1,0x8f",
		"-1,0,0x20,0x7,1,1,0x77",

		/* Drive output pins:
		    Pin 0.4: QSFP_RST_N=1
		    Pin 0.5: QSFP_MODSEL_N=1
		    Pin 0.6: QSFP_LPMODE=1
		    Pin 1.3: SFP_TX_DISABLE_0=0
		    Pin 1.7: SFP_TX_DISABLE_1=0 */
		"-1,0,0x20,0x2,1,1,0x70",
		"-1,0,0x20,0x3,1,1,0x00";

        /* Allow a sequence of MDIO writes to be performed during boot. Each
        string in the list line is executed in sequence. The MDIO write
        format is:
            clause,node,bus_id,phy_id,device,location,val
            sleep,ms
        clause   = MDIO clause for the write (22 or 45)
        node     = ThunderX node the MDIO bus is connected, -1 for local
        bus_id   = ThunderX MDIO bus to use
        phy_id   = MDIO address
        device   = Clause 45 internal device address, zero for clause 22
        location = MDIO register
        val      = Value to write
        sleep,ms = This on a line delays for 'ms' milliseconds */
	MDIO-WRITE =
		/* The Cortina PHY shows up on MDIO bus 1, PHY address 0 and 1.
		    Each PHY is divided into 4 slices, one per SERDES lane. The
		    40G port uses all slices, where the 10G ports use one slice
		    each. PHY Internal address is always zero.
		    XLAUI0: Slice 0-3 of PHY address 1 (reg through reg + 0x3000)
		    XFI1.0: Slice 3 of PHY address 0 (reg + 0x3000)
		    XFI1.1: Slice 2 of PHY address 0 (reg + 0x2000)

		    Reset the line side of the PHY. This is register 0x1000,
		    which is incremented by 0x1000 for each slice.
		    Reset the host side of the PHY. This is register 0x1800,
		    which is incremented by 0x1000 for each slice. */
		/* XLAUI0, all 4 slices */
		"45,0,1,1,0,0x1000,0x3",
		"45,0,1,1,0,0x1800,0x3",
		"45,0,1,1,0,0x2000,0x3",
		"45,0,1,1,0,0x2800,0x3",
		"45,0,1,1,0,0x3000,0x3",
		"45,0,1,1,0,0x3800,0x3",
		"45,0,1,1,0,0x4000,0x3",
		"45,0,1,1,0,0x4800,0x3",
		/* XFI1.0, slice 3 */
		"45,0,1,0,0,0x4000,0x3",
		"45,0,1,0,0,0x4800,0x3",
		/* XFI1.1, slice 2 */
		"45,0,1,0,0,0x3000,0x3",
		"45,0,1,0,0,0x3800,0x3",
		/* Leave PHY in reset for 100ms */
		"sleep,100",
		/* Take the line side out of reset */
		"45,0,1,1,0,0x1000,0",
		"45,0,1,1,0,0x1800,0",
		"45,0,1,1,0,0x2000,0",
		"45,0,1,1,0,0x2800,0",
		"45,0,1,1,0,0x3000,0",
		"45,0,1,1,0,0x3800,0",
		"45,0,1,1,0,0x4000,0",
		"45,0,1,1,0,0x4800,0",
		/* XFI1.0, slice 3 */
		"45,0,1,0,0,0x4000,0",
		"45,0,1,0,0,0x4800,0",
		/* XFI1.1, slice 2 */
		"45,0,1,0,0,0x3000,0",
		"45,0,1,0,0,0x3800,0";

	/* PHY address encoding:
	    Bits[31:24]: Node ID, 0xff for node the ethernet device is on
	    Bits[23:16]: Only used for TWSI
	    Bits[15:12]: PHY connection type (0=MDIO, 1=Fixed, 2=TWSI)
	For MDIO:
	    Bits[31:24]: Node ID, 0xff for node the ethernet device is on
	    Bits[23:16]: 0
	    Bits[15:12]: 0=MDIO
	    Bits[11:8]: MDIO bus number
	    Bits[7:0]: MDIO address
	For Fixed:
	    Bits[31:24]: 0
	    Bits[23:16]: Zero
	    Bits[15:12]: 1=Fixed
	    Bits[11:0]:  0 = 1Gb, 1 = 100Mb
	For TWSI:
	    Bits[31:24]: Node ID, 0xff for node the ethernet device is on
	    Bits[23:16]: TWSI internal address width in bytes (0-2)
	    Bits[15:12]: 2=TWSI
	    Bits[11:8]: TWSI bus number
	    Bits[7:0]: TWSI address */
	// BGX0 (QLM0) is QSFP on MDIO bus 1, address 1
	PHY-ADDRESS.N0.BGX0.P0 = "0x101";
	// BGX1 (QLM1) is SFP on MDIO bus 1, address 0
	PHY-ADDRESS.N0.BGX1.P0 = "0x100";
	PHY-ADDRESS.N0.BGX1.P1 = "0x100";

	/* Independent enables for each BGX port of THUNDERX. Use this to
	disable ports that are not wired on a board. Default is that all
	ports are enabled. */
	BGX-ENABLE.N0.BGX1.P2 = "0";
	BGX-ENABLE.N0.BGX1.P3 = "0";

	/* Determine how multi-node is supported for this system:
	    0 = Multi-node is not supported
	    1 = Multi-node is supported and booting requires two nodes
	    2 = Multi-node is auto detected. Two nodes are used if
		if available, otherwise fall back to single node. */
	MULTI-NODE = "0";

	/* Set the mode of a QLM. The possible mode strings are:
	    DISABLED
	    PCIE_1X1
	    PCIE_2X1
	    PCIE_1X2
	    PCIE_1X4
	    PCIE_1X8
	    SATA_4X1
	    SATA_2X1
	    ILK
	    SGMII_4X1
	    SGMII_2X1
	    XAUI_1X4
	    RXAUI_2X2
	    RXAUI_1X2
	    OCI
	    XFI_4X1
	    XFI_2X1
	    XLAUI_1X4
	    10G_KR_4X1
	    10G_KR_2X1
	    40G_KR4_1X4 */
	QLM-MODE.N0.QLM0 = "XLAUI_1X4";
	QLM-MODE.N0.QLM1 = "XFI_4X1";
	QLM-MODE.N0.QLM2 = "PCIE_1X4";
	QLM-MODE.N0.QLM3 = "SATA_4X1";
	QLM-MODE.N0.QLM4 = "PCIE_1X8";
	QLM-MODE.N0.QLM6 = "PCIE_1X8";

	/* Set the speed of a QLM in Mhz. The possible speeds are:
	    1250
	    2500
	    3125
	    5000
	    6250
	    8000
	   10312 */
	QLM-FREQ.N0.QLM0 = "10312";
	QLM-FREQ.N0.QLM1 = "10312";
	QLM-FREQ.N0.QLM2 = "8000";
	QLM-FREQ.N0.QLM3 = "6000";
	QLM-FREQ.N0.QLM4 = "8000";
	QLM-FREQ.N0.QLM6 = "8000";

	/* Set the source of the QLM reference clock:
	    0 = Common clock 0
	    1 = Common clokc 1
	    2 = QLM external reference */
	QLM-CLK.N0 = "0";
	QLM-CLK.N0.QLM0 = "1";
	QLM-CLK.N0.QLM1 = "1";

	/* DRAM configuration name to use for the board. This coresponds to
	a file in lib-dram/configs/config-*.c. FIXME */
	DDR-CONFIG = "cn88xx-crb-1s";

	/* Specify the debug logging level during DRAM initialization. Zero
	disables debug logging. The possible debug levels are:
	    TBD */
	//DDR-VERBOSE = "0";

	/* Specify a THUNDERX GPIO used to control power for a USB port. When
	set, the USB host controller will toggle the GPIO automatically
	during USB reset events. The default value assumes THUNDERX has no
	control of the USB power and it is always on. */
	//USB-PWR-GPIO.N%d.PORT%d = "-1";
};
};

