/dts-v1/;

/ {
cavium,bdk {
	/* Determine how multi-node is supported for this system:
	    0 = Multi-node is not supported
	    1 = Multi-node is supported and booting requires two nodes
	    2 = Multi-node is auto detected. Two nodes are used if
		if available, otherwise fall back to single node. */
	MULTI-NODE = "2";

	/* Set the mode of a QLM. The possible mode strings are:
	    DISABLED
	    PCIE_1X1
	    PCIE_2X1
	    PCIE_1X2
	    PCIE_1X4
	    PCIE_1X8
	    SATA_4X1
	    SATA_2X1
	    ILK
	    SGMII_4X1
	    SGMII_2X1
	    XAUI_1X4
	    RXAUI_2X2
	    RXAUI_1X2
	    OCI
	    XFI_4X1
	    XFI_2X1
	    XLAUI_1X4
	    10G_KR_4X1
	    10G_KR_2X1
	    40G_KR4_1X4 */
	QLM-MODE.N0.QLM0 = "XFI_4X1";
	QLM-MODE.N0.QLM1 = "XAUI_1X4";
	QLM-MODE.N0.QLM2 = "PCIE_1X8";
	QLM-MODE.N0.QLM4 = "PCIE_1X8";
	QLM-MODE.N0.QLM6 = "SATA_4X1";
	QLM-MODE.N0.QLM7 = "SATA_4X1";

	/* Set the speed of a QLM in Mhz. The possible speeds are:
	    1250
	    2500
	    3125
	    5000
	    6250
	    8000
	   10312 */
	QLM-FREQ.N0.QLM0 = "10312";
	QLM-FREQ.N0.QLM1 = "6250";
	QLM-FREQ.N0.QLM2 = "8000";
	QLM-FREQ.N0.QLM4 = "8000";
	QLM-FREQ.N0.QLM6 = "6000";
	QLM-FREQ.N0.QLM7 = "6000";

	/* Set the source of the QLM reference clock:
	    0 = Common clock 0
	    1 = Common clokc 1
	    2 = QLM external reference */
	QLM-CLK.N0 = "0";
	QLM-CLK.N0.QLM0 = "1";
	QLM-CLK.N0.QLM1 = "1";
};
};

