/include/ "ddr3-common.dtsi"

/ {
cavium,bdk {
	/* Board model number. This is used to determine the name of the
	configuration file containing the boards default settings. This
	parameter is stored in a static board manufacturing area at the
	top of the boot flash. */
	//BOARD-MODEL = "unknown";

	/* The board revision level. This parameter is stored in a static
	board manufacturing area at the top of the boot flash. */
	//BOARD-REVISION = "unknown";

	/* Unique string used as a serial number. This parameter is stored
	in a static board manufacturing area at the top of the boot flash. */
	//BOARD-SERIAL = "unknown";

	/* The first MAC address assigned to the THUNDERX network ports. MAC
	addresses are in a contiguous block starting at this address and
	containing BOARD-MAC-ADDRESS-NUM number of addresses. The format
	of this parameter is 0xXXXXXXXXXXXX, 12 hex digits starting with
	'0x'.This parameter is stored in a static board manufacturing
	area at the top of the boot flash. */
	//BOARD-MAC-ADDRESS = "0x20fb7000000";

	/* The number of MAC addresses assigned to the THUNDERX network
	ports. See BOARD-MAC-ADDRESS for the actual MAC address numeric
	value.This parameter is stored in a static board manufacturing
	area at the top of the boot flash. */
	//BOARD-MAC-ADDRESS-NUM = "0";

	/* THUNDERX TWSI port connected to the BMC for IPMI traffic.
	-1 = No connection exists. 0+ is TWSI bus number. */
	//BMC-TWSI = "-1";

	/* This specifies a watchdog timer should run during boot and reset
	the chip if boot hangs for some reason. The timeout is specified
	in milliseconds. Zero disables the watchdog. */
	//WATCHDOG-TIMEOUT = "0";

	/* Allow a sequence of TWSI writes to be performed during boot. Each
	string in the list line is executed in sequence. The TWSI write
	format is:
	    node,twsi_id,dev_addr,internal_addr,num_bytes,ia_width_bytes,data
	    sleep,ms
	node           = THUNDERX node ID the twsi bus is on. -1 means the local node
	twsi_id        = THUNDERX twsi bus to use
	dev_addr       = TWSI bus address
	internal_addr  = TWSI internal address, zero if not used
	num_bytes      = Number of bytes to write (1-8)
	ia_width_bytes = Internal address width in bytes (0-2)
	data           = Data to write as a 64bit number
	sleep,ms       = This on a line delays for 'ms' milliseconds */
	//TWSI-WRITE = "";

	/* Allow a sequence of MDIO writes to be performed during boot. Each
	string in the list line is executed in sequence. The MDIO write
	format is:
	    clause,node,bus_id,phy_id,device,location,val
	    sleep,ms
	clause   = MDIO clause for the write (22 or 45)
	node     = THUNDERX node the MDIO bus is connected, -1 for local
	bus_id   = THUNDERX MDIO bus to use
	phy_id   = MDIO address
	device   = Clause 45 internal device address, zero for clause 22
	location = MDIO register
	val      = Value to write
	sleep,ms = This on a line delays for 'ms' milliseconds */
	//MDIO-WRITE = "";

	/* PHY address encoding:
	    Bits[31:24]: Node ID, 0xff for node the ethernet device is on
	    Bits[23:16]: Only used for TWSI
	    Bits[15:12]: PHY connection type (0=MDIO, 1=Fixed, 2=TWSI)
	For MDIO:
	    Bits[31:24]: Node ID, 0xff for node the ethernet device is on
	    Bits[23:16]: 0
	    Bits[15:12]: 0=MDIO
	    Bits[11:8]: MDIO bus number
	    Bits[7:0]: MDIO address
	For Fixed:
	    Bits[31:24]: 0
	    Bits[23:16]: Zero
	    Bits[15:12]: 1=Fixed
	    Bits[11:0]:  0 = 1Gb, 1 = 100Mb
	For TWSI:
	    Bits[31:24]: Node ID, 0xff for node the ethernet device is on
	    Bits[23:16]: TWSI internal address width in bytes (0-2)
	    Bits[15:12]: 2=TWSI
	    Bits[11:8]: TWSI bus number
	    Bits[7:0]: TWSI address */
	//PHY-ADDRESS.N%d.BGX%d.P%d = "-1";
	// When board is running as Node 0
	// BGX0 (QLM0) PHY addresses
	PHY-ADDRESS.N0.BGX0.P0 = "0xff000000";
	PHY-ADDRESS.N0.BGX0.P1 = "0xff000001";
	PHY-ADDRESS.N0.BGX0.P2 = "0xff000002";
	PHY-ADDRESS.N0.BGX0.P3 = "0xff000003";
	// BGX1 (QLM1) PHY addresses
	PHY-ADDRESS.N0.BGX1.P0 = "0xff000104";
	PHY-ADDRESS.N0.BGX1.P1 = "0xff000105";
	PHY-ADDRESS.N0.BGX1.P2 = "0xff000106";
	PHY-ADDRESS.N0.BGX1.P3 = "0xff000107";

	// When board is running as Node 1
	// BGX0 (QLM0) PHY addresses
	PHY-ADDRESS.N1.BGX0.P0 = "0xff000000";
	PHY-ADDRESS.N1.BGX0.P1 = "0xff000001";
	PHY-ADDRESS.N1.BGX0.P2 = "0xff000002";
	PHY-ADDRESS.N1.BGX0.P3 = "0xff000003";
	// BGX1 (QLM1) PHY addresses
	PHY-ADDRESS.N1.BGX1.P0 = "0xff000104";
	PHY-ADDRESS.N1.BGX1.P1 = "0xff000105";
	PHY-ADDRESS.N1.BGX1.P2 = "0xff000106";
	PHY-ADDRESS.N1.BGX1.P3 = "0xff000107";

	/* Independent enables for each BGX port of THUNDERX. Use this to
	disable ports that are not wired on a board. Default is that all
	ports are enabled. */
	//BGX-ENABLE.N%d.BGX%d.P%d = "1";

	/* Number of packet buffers in the BDK. */
	//BDK-NUM-PACKET-BUFFERS = "0x1000";

	/* The size of each packet buffer in the BDK. */
	//BDK-PACKET-BUFFER-SIZE = "0x400";

	/* Controls whether the BDK displays link status messages. */
	//BDK-SHOW-LINK-STATUS = "1";

	/* Controls the cores used by the BDK. Zero means all cores. */
	//BDK-COREMASK = "0";

	/* Timeout for the boot menu in seconds. */
	//BDK-BOOT-MENU-TIMEOUT = "0xa";

	/* This is used by the boot menu to control which boot path the init
	code chooses. The supported options are
	    0 = Normal boot path
	    1 = Diagnostics boot path */
	//BDK-BOOT-PATH-OPTION = "0";

	/* BDK trace level. This is a bitmask of the enumeration defined in
	bdk-trace.h. Each bit turns on tracing of a specific BDK
	component. */
	//BDK-CONFIG-TRACE = "0";

	/* Determine how multi-node is supported for this system:
	    0 = Multi-node is not supported
	    1 = Multi-node is supported and booting requires two nodes
	    2 = Multi-node is auto detected. Two nodes are used if
	        if available, otherwise fall back to single node. */
	//MULTI-NODE = "2";
	MULTI-NODE = "2";

	/* Determine if internal PCIe ECAMs support Enhanced Allocation(EA):
	    0 = Enhanced Allocation is not supported
	    1 = Enhanced Allocation is supported
	Note EA is not supported on CN88XX pass 1.x, and is always
	disabled. */
	//PCIE-ENHANCED-ALLOCATION = "1";

	/* For Cavium evaluation boards, query the MCU for QLM setup
	information. The MCU supplies a TWSI protocol for THUNDERX to
	query the modules plugged in and automatically set the QLMs to
	the correct mode. This should only be enabled(1) on Cavium
	EBB8XXX boards. Other boards should have it disabled(0). */
	//QLM-AUTO-CONFIG = "0";
	QLM-AUTO-CONFIG = "1";

	/* Set the mode of a QLM. The possible mode strings are:
	    DISABLED
	    PCIE_1X1
	    PCIE_2X1
	    PCIE_1X2
	    PCIE_1X4
	    PCIE_1X8
	    SATA_4X1
	    SATA_2X1
	    ILK
	    SGMII_4X1
	    SGMII_2X1
	    XAUI_1X4
	    RXAUI_2X2
	    RXAUI_1X2
	    OCI
	    XFI_4X1
	    XFI_2X1
	    XLAUI_1X4
	    10G_KR_4X1
	    10G_KR_2X1
	    40G_KR4_1X4 */
	//QLM-MODE.N%d.QLM%d = "";

	/* Set the speed of a QLM in Mhz. The possible speeds are:
	    1250
	    1500
	    2500
	    3000
	    3125
	    5000
	    6000
	    6250
	    8000
	   10312 */
	//QLM-FREQ.N%d.QLM%d = "0";

	/* Set the source of the QLM reference clock:
	    0 = Common clock 0
	    1 = Common clock 1
	    2 = QLM external reference */
	//QLM-CLK.N%d.QLM%d = "2";

	/* Setting of GSERX_LANEX_TX_CFG_0[CFG_TX_SWING] for the QLM. This
	should only be used for QLMs used for BGX and CCPI not using KR
	training. */
	//QLM-TUNING-TX-SWING.N%d.QLM%d.LANE%d = "-1";

	/* Setting of GSERX_LANEX_TX_PRE_EMPHASIS[CFG_TX_PREMPTAP] for the
	QLM. This should only be used for QLMs used for BGX and CCPI not
	using KR training. CFG_TX_PREMPTAP:
	    Bits[8:5] = Tx Post Tap; Bits[3:0] = Tx Pre Tap */
	//QLM-TUNING-TX-PREMPTAP.N%d.QLM%d.LANE%d = "-1";

	/* Setting of GSERX_LANEX_TX_CFG_3[PCS_SDS_TX_GAIN] for the QLM. This
	should only be used for QLMs used for BGX and CCPI not using KR
	training. */
	//QLM-TUNING-TX-GAIN.N%d.QLM%d.LANE%d = "-1";

	/* Setting of GSERX_LANEX_TX_CFG_3[CFG_TX_VBOOST_EN] for the QLM. This
	should only be used for QLMs used for BGX and CCPI not using KR
	training. */
	//QLM-TUNING-TX-VBOOST.N%d.QLM%d.LANE%d = "-1";

	/* Speed to use for DRAM in MT/s. Zero means use the factory
	default. Hardware may adjust this value slightly to improve
	DRAM stability, so scope measurements may not exactly match
	the frequency with MT/s.
	Parameters:
	    N#: Parameter can be different for each node. This specifies
	        which node the value is for. Node must be 0-3. Optional. */
	//DDR-SPEED.N%d = "0";
	DDR-SPEED = "1866";

	/* TWSI address of the DIMM SPD. The encoding of this address is
	:    [15:12]: TWSI bus the DIMM is connected to.
	     [11:7]: Reserved, set to zero.
	      [6:0]: TWSI address for the DIMM.
	A value of zero means the DIMMs are not accessible. Hard coded
	values will be read from DDR-CONFIG-SPD-DATA.Parameters:
	    LMC#: Parameter can be different for memory controller. This
	        specifies which LMC the value is for. LMC must be
	        0-3. Optional.
	    N#: Parameter can be different for each node. This specifies
	        which node the value is for. Node must be 0-3. Optional. */
	//DDR-CONFIG-SPD-ADDR.DIMM%d.LMC%d.N%d = "0";
	DDR-CONFIG-SPD-ADDR.DIMM0.LMC0 = "0x1050";
	DDR-CONFIG-SPD-ADDR.DIMM1.LMC0 = "0x1051";
	DDR-CONFIG-SPD-ADDR.DIMM0.LMC1 = "0x1052";
	DDR-CONFIG-SPD-ADDR.DIMM1.LMC1 = "0x1053";
	DDR-CONFIG-SPD-ADDR.DIMM0.LMC2 = "0x1054";
	DDR-CONFIG-SPD-ADDR.DIMM1.LMC2 = "0x1055";
	DDR-CONFIG-SPD-ADDR.DIMM0.LMC3 = "0x1056";
	DDR-CONFIG-SPD-ADDR.DIMM1.LMC3 = "0x1057";

        /* Other DRAM settings are read from ddr3-common.dtsi */

	/* Specify a THUNDERX GPIO used to control power for a USB port. When
	set, the USB host controller will toggle the GPIO automatically
	during USB reset events. The default value assumes THUNDERX has no
	control of the USB power and it is always on. */
	//USB-PWR-GPIO.N%d.PORT%d = "-1";

        /* Specify the polarity of a THUNDERX GPIO used to control power for
        a USB port. The GPIO used is specified by USB-PWR-GPIO. Setting this
        GPIO low. The default value drives the GPIO high. */
        //USB-PWR-GPIO-POLARITY.N%d.PORT%d = "1";

	/* Number of reading with no errors to signal the start of an
	eye. The default value should be good for most cases. */
	//QLM-EYE-NUM-ZEROS = "2";

	/* Time to sample at each location in microseconds. The default
	value should be good for most cases. */
	//QLM-EYE-SAMPLE-TIME = "0x190";

	/* Time to settle after each movement in microseconds. The
	default value should be good for most cases. */
	//QLM-EYE-SETTLE-TIME = "0x32";

	/**********************************************************************
	 * The entries below are currently not used by the BDK. They are being
	 * used only by ATF / UEFI.
	 *
	 * Format for TWSI configuration:
	 *   TWSI-VAR-NAME = 0x01050E
	 *                     ||||||
	 *                     ||||++-- TWSI address
	 *                     ||++---- TWSI bus
	 *                     ++------ Node ID (0xFF = local node)
	 *
	 * Format for GPIO configuration:
	 *   GPIO-VAR-NAME = 0x01001A
	 *                     ||||||
	 *                     ||||++-- GPIO Number
	 *                     |||+---- GPIO polarity (0=normal, 1=inverted)
	 *                     ||+----- GPIO type (0=level, 1=edge)
	 *                     ++------ Node ID (0xFF = local node)
	 *
	 **********************************************************************/

	/* RTC connection over TWSI bus of Thunder.
	   -1 =  No connection exists  */
	//RTC-TWSI-CONFIG = "-1";
	RTC-TWSI-CONFIG = "0x000068";
}; /* cavium,bdk */
}; /* / */

