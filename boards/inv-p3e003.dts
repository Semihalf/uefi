/dts-v1/;

/ {
chosen {
cavium-bdk {
	/* THUNDERX TWSI port connected to the BMC for IPMI traffic.
	-1 = No connection exists. 0+ is TWSI bus number. */
	//BMC-TWSI = "1";

	/* Allow a sequence of TWSI writes to be performed during boot. Each
	TWSI-WRITE-# line is executed in sequence starting with
	TWSI-WRITE-0 and incrementing the number. The TWSI write format is:
	    node,twsi_id,dev_addr,internal_addr,num_bytes,ia_width_bytes,data
	node           = ThunderX node ID the twsi bus is on. -1 means the local node
	twsi_id        = ThunderX twsi bus to use
	dev_addr       = TWSI bus address
	internal_addr  = TWSI internal address, zero if not used
	num_bytes      = Number of bytes to write (1-8)
	ia_width_bytes = Internal address width in bytes (0-2)
	data           = Data to write as a 64bit number */
	//TWSI-WRITE-%d = "";

	/* Allow a sequence of MDIO writes to be performed during boot. Each
	MDIO-WRITE-# line is executed in sequence starting with
	MDIO-WRITE-0 and incrementing the number. The MDIO write format is:
	    clause,node,bus_id,phy_id,device,location,val
	clause   = MDIO clause for the write (22 or 45)
	node     = ThunderX node the MDIO bus is connected, -1 for local
	bus_id   = ThunderX MDIO bus to use
	phy_id   = MDIO address
	device   = Clause 45 internal device address, zero for clause 22
	location = MDIO register
	val      = Value to write */
	//MDIO-WRITE-%d = "";

	/* PHY address encoding:
	    Bits[31:24]: Node ID, 0xff for node the etherent device is on
	    Bits[23:16]: Only used for TWSI
	    Bits[15:12]: PHY connection type (0=MDIO, 1=Fixed, 2=TWSI)
	For MDIO:
	    Bits[31:24]: Node ID, 0xff for node the etherent device is on
	    Bits[23:16]: 0
	    Bits[15:12]: 0=MDIO
	    Bits[11:8]: MDIO bus number
	    Bits[7:0]: MDIO address
	For Fixed:
	    Bits[31:24]: 0
	    Bits[23:16]: Zero
	    Bits[15:12]: 1=Fixed
	    Bits[11:0]:  0 = 1Gb, 1 = 100Mb
	For TWSI:
	    Bits[31:24]: Node ID, 0xff for node the etherent device is on
	    Bits[23:16]: TWSI internal address width in bytes (0-2)
	    Bits[15:12]: 2=TWSI
	    Bits[11:8]: TWSI bus number
	    Bits[7:0]: TWSI address */
	PHY-ADDRESS.N0.BGX0.P0 = "0x11f";
	PHY-ADDRESS.N0.BGX0.P1 = "0x11f";

	/* Independent enables for each BGX port of THUNDERX. Use this to
	disable ports that are not wired on a board. Default is that all
	ports are enabled. */
	//BGX-ENABLE.N%d.BGX%d.P%d = "1";

	/* Determine how multi-node is supported for this system:
	    0 = Multi-node is not supported
	    1 = Multi-node is supported and booting requires two nodes
	    2 = Multi-node is auto detected. Two nodes are used if
		if available, otherwise fall back to single node. */
	MULTI-NODE = "1";

	/* Set the mode of a QLM. The possible mode strings are:
	    DISABLED
	    PCIE_1X1
	    PCIE_2X1
	    PCIE_1X2
	    PCIE_1X4
	    PCIE_1X8
	    SATA_4X1
	    SATA_2X1
	    ILK
	    SGMII_4X1
	    SGMII_2X1
	    XAUI_1X4
	    RXAUI_2X2
	    RXAUI_1X2
	    OCI
	    XFI_4X1
	    XFI_2X1
	    XLAUI_1X4
	    10G_KR_4X1
	    10G_KR_2X1
	    40G_KR4_1X4 */
	QLM-MODE.N0.QLM0 = "XFI_4X1";
	QLM-MODE.N0.QLM2 = "SATA_4X1";
	QLM-MODE.N0.QLM3 = "SATA_4X1";
	QLM-MODE.N0.QLM4 = "PCIE_1X4";
	QLM-MODE.N0.QLM6 = "SATA_4X1";
	QLM-MODE.N0.QLM7 = "SATA_4X1";

	QLM-MODE.N1.QLM0 = "XFI_4X1";
	QLM-MODE.N1.QLM2 = "PCIE_1X8";
	QLM-MODE.N1.QLM4 = "PCIE_1X8";
	QLM-MODE.N1.QLM6 = "PCIE_1X8";

	/* Set the speed of a QLM in Mhz. The possible speeds are:
	    1250
	    2500
	    3125
	    5000
	    6250
	    8000
	   10312 */
	//QLM-FREQ.N%d.QLM%d = "0";
	QLM-FREQ.N0.QLM0 = "10312";
	QLM-FREQ.N0.QLM2 = "6000";
	QLM-FREQ.N0.QLM3 = "6000";
	QLM-FREQ.N0.QLM4 = "8000";
	QLM-FREQ.N0.QLM6 = "6000";
	QLM-FREQ.N0.QLM7 = "6000";

	QLM-FREQ.N1.QLM0 = "10312";
	QLM-FREQ.N1.QLM2 = "8000";
	QLM-FREQ.N1.QLM4 = "8000";
	QLM-FREQ.N1.QLM6 = "8000";

	/* Set the source of the QLM reference clock:
	    0 = Common clock 0
	    1 = Common clokc 1
	    2 = QLM external reference */
	QLM-CLK.N0 = "2";
	QLM-CLK.N1 = "2";

	/* DRAM configuration name to use for the board. This coresponds to
	a file in lib-dram/configs/config-*.c. FIXME */
	DDR-CONFIG = "inv-p3e003";

	/* Specify the debug logging level during DRAM initialization. Zero
	disables debug logging. The possible debug levels are:
	    TBD */
	//DDR-VERBOSE = "0";

	/* Specify a THUNDERX GPIO used to control power for a USB port. When
	set, the USB host controller will toggle the GPIO automatically
	during USB reset events. The default value assumes THUNDERX has no
	control of the USB power and it is always on. */
	USB-PWR-GPIO = "38";
};
};
};

