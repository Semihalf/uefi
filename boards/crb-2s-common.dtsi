/include/ "ddr4-common.dtsi"

/ {
cavium,bdk {
	/* On-chip TWSI port connected to the BMC for IPMI traffic.
	-1 = No connection exists. 0+ is TWSI bus number. */
	//BMC-TWSI = "-1";
	BMC-TWSI = "1";

	/* This specifies a watchdog timer should run during boot and reset
	the chip if boot hangs for some reason. The timeout is specified
	in milliseconds. Zero disables the watchdog. */
	//WATCHDOG-TIMEOUT = "0";

	/* Allow a sequence of TWSI writes to be performed during boot. Each
	string in the list line is executed in sequence. The TWSI write
	format is:
	    node,twsi_id,dev_addr,internal_addr,num_bytes,ia_width_bytes,data
	    sleep,ms
	node           = Node ID the twsi bus is on. -1 means the local node
	twsi_id        = TWSI bus to use
	dev_addr       = TWSI bus address
	internal_addr  = TWSI internal address, zero if not used
	num_bytes      = Number of bytes to write (1-8)
	ia_width_bytes = Internal address width in bytes (0-2)
	data           = Data to write as a 64bit number
	sleep,ms       = This on a line delays for 'ms' milliseconds */
	//TWSI-WRITE = "";

	/* Allow a sequence of MDIO writes to be performed during boot. Each
	string in the list line is executed in sequence. The MDIO write
	format is:
	    clause,node,bus_id,phy_id,device,location,val
	    sleep,ms
	clause   = MDIO clause for the write (22 or 45)
	node     = Node the MDIO bus is connected, -1 for local
	bus_id   = MDIO bus to use
	phy_id   = MDIO address
	device   = Clause 45 internal device address, zero for clause 22
	location = MDIO register
	val      = Value to write
	sleep,ms = This on a line delays for 'ms' milliseconds */
	//MDIO-WRITE = "";
	MDIO-WRITE =
		/* On the CRB-2S the PHYs for both nodes are connect to node 0
			Setup the status lights for the PHYs */
		// CPU0 SFP+
		"45,0,1,1,0,0x010c,0xB610",
		"45,0,1,1,0,0x010d,0x0012",
		"45,0,1,1,0,0x0110,0x0000",
		"45,0,1,1,0,0x0111,0x0000",
		// CPU0 QSFP+
		"45,0,1,0,0,0x0106,0x6610",
		"45,0,1,0,0,0x0107,0x0012",
		"45,0,1,0,0,0x010a,0x0000",
		"45,0,1,0,0,0x010b,0x0000",
		// CPU1 SFP+
		"45,0,1,1,0,0x0106,0x6610",
		"45,0,1,1,0,0x0107,0x0032",
		"45,0,1,1,0,0x010a,0x0000",
		"45,0,1,1,0,0x010b,0x0000",
		/* The Cortina PHY shows up on MDIO bus 1, PHY address 0 and 1.
		    Each PHY is divided into 4 slices, one per SERDES lane. The
		    40G port uses all slices, where the 10G ports use one slice
		    each. PHY Internal address is always zero.
		    N0.XLAUI1: Slice 0-3 of PHY address 0 (reg through reg + 0x3000)
		    N0.XFI0.0: Slice 0 of PHY address 1 (reg)
		    N1.XFI0.0: Slice 1 of PHY address 1 (reg + 0x1000)

		    Reset the line side of the PHY. This is register 0x1000,
		    which is incremented by 0x1000 for each slice.
		    Reset the host side of the PHY. This is register 0x1800,
		    which is incremented by 0x1000 for each slice. */
		/* XLAUI0, all 4 slices */
		"45,0,1,0,0,0x1000,0x3",
		"45,0,1,0,0,0x1800,0x3",
		"45,0,1,0,0,0x2000,0x3",
		"45,0,1,0,0,0x2800,0x3",
		"45,0,1,0,0,0x3000,0x3",
		"45,0,1,0,0,0x3800,0x3",
		"45,0,1,0,0,0x4000,0x3",
		"45,0,1,0,0,0x4800,0x3",
		/* N0.XFI1.0, slice 0 */
		"45,0,1,1,0,0x1000,0x3",
		"45,0,1,1,0,0x1800,0x3",
		/* N1.XFI1.0, slice 1 */
		"45,0,1,1,0,0x2000,0x3",
		"45,0,1,1,0,0x2800,0x3",
		/* Leave PHY in reset for 100ms */
		"sleep,100",
		/* Take the line side out of reset */
		"45,0,1,0,0,0x1000,0",
		"45,0,1,0,0,0x1800,0",
		"45,0,1,0,0,0x2000,0",
		"45,0,1,0,0,0x2800,0",
		"45,0,1,0,0,0x3000,0",
		"45,0,1,0,0,0x3800,0",
		"45,0,1,0,0,0x4000,0",
		"45,0,1,0,0,0x4800,0",
		/* N0.XFI1.0, slice 0 */
		"45,0,1,1,0,0x1000,0",
		"45,0,1,1,0,0x1800,0",
		/* N1.XFI1.0, slice 1 */
		"45,0,1,1,0,0x2000,0",
		"45,0,1,1,0,0x2800,0";

	/* PHY address encoding:
	    Bits[31:24]: Node ID, 0xff for node the ethernet device is on
	    Bits[23:16]: Only used for TWSI
	    Bits[15:12]: PHY connection type (0=MDIO, 1=Fixed, 2=TWSI)
	For MDIO:
	    Bits[31:24]: Node ID, 0xff for node the ethernet device is on
	    Bits[23:16]: 0
	    Bits[15:12]: 0=MDIO
	    Bits[11:8]: MDIO bus number
	    Bits[7:0]: MDIO address
	For Fixed:
	    Bits[31:24]: 0
	    Bits[23:16]: Zero
	    Bits[15:12]: 1=Fixed
	    Bits[11:0]:  0 = 1Gb, 1 = 100Mb
	For TWSI:
	    Bits[31:24]: Node ID, 0xff for node the ethernet device is on
	    Bits[23:16]: TWSI internal address width in bytes (0-2)
	    Bits[15:12]: 2=TWSI
	    Bits[11:8]: TWSI bus number
	    Bits[7:0]: TWSI address */
	//PHY-ADDRESS.N%d.BGX%d.P%d = "-1";
	/* N0.BGX0 (QLM0, Lane 0) upper SFP+ module uses Node 0, TWSI bus 3,
            addresses 0x50 and 0x56, with one internal address byte. The
            addresses are only readable when a 1Gbps SFP+ is installed.
            0x50 is a read only rom, 0x56 are the modules registers. */
	PHY-ADDRESS.N0.BGX0.P0 = "0x00012356";
	/* N0.BGX1 (QLM1, Lane 0-3) QSFP+ module uses Node 0, TWSI bus 4,
            address 0x50. This is currently not used by the BDK */
	//PHY-ADDRESS.N0.BGX1.P0 = "0x00012450";
	/* N1.BGX0 (QLM0, Lane 0) lower SFP+ module uses Node 1, TWSI bus 3,
            addresses 0x50 and 0x56, with one internal address byte. The
            addresses are only readable when a 1Gbps SFP+ is installed.
            0x50 is a read only rom, 0x56 are the modules registers. */
	PHY-ADDRESS.N1.BGX0.P0 = "0x01012356";

	/* Independent enables for each on-chip BGX port. Use this to
	disable ports that are not wired on a board. Default is that all
	ports are enabled. */
	//BGX-ENABLE.N%d.BGX%d.P%d = "1";
	BGX-ENABLE.N0.BGX0.P1 = "0";
	BGX-ENABLE.N0.BGX0.P2 = "0";
	BGX-ENABLE.N0.BGX0.P3 = "0";
	BGX-ENABLE.N1.BGX0.P1 = "0";
	BGX-ENABLE.N1.BGX0.P2 = "0";
	BGX-ENABLE.N1.BGX0.P3 = "0";

	/* Number of packet buffers in the BDK. */
	//BDK-NUM-PACKET-BUFFERS = "0x1000";

	/* The size of each packet buffer in the BDK. */
	//BDK-PACKET-BUFFER-SIZE = "0x400";

	/* Controls whether the BDK displays link status messages. */
	//BDK-SHOW-LINK-STATUS = "1";

	/* Controls the cores used by the BDK. Zero means all cores. */
	//BDK-COREMASK = "0";

	/* Timeout for the boot menu in seconds. */
	//BDK-BOOT-MENU-TIMEOUT = "0xa";

	/* This is used by the boot menu to control which boot path the init
	code chooses. The supported options are
	    0 = Normal boot path
	    1 = Diagnostics boot path */
	//BDK-BOOT-PATH-OPTION = "0";

	/* This is used by the boot apps to determine the next boot stage.
	    e.g.:
	      BDK-CONFIG-BOOT-NEXT-STAGE-INIT=/fatfs/cortina-app.bin */
	//BDK-CONFIG-BOOT-NEXT-STAGE-%s = "";

	/* BDK trace level. This is a bitmask of the enumeration defined in
	bdk-trace.h. Each bit turns on tracing of a specific BDK
	component. */
	//BDK-CONFIG-TRACE = "0";

	/* Determine how multi-node is supported for this system:
	    0 = Multi-node is not supported
	    1 = Multi-node is supported and booting requires two nodes
	    2 = Multi-node is auto detected. Two nodes are used if
	        if available, otherwise fall back to single node. */
	//MULTI-NODE = "2";
	MULTI-NODE = "1";

	/* Determine if internal PCIe ECAMs support Enhanced Allocation(EA):
	    0 = Enhanced Allocation is not supported
	    1 = Enhanced Allocation is supported
	Note EA is not supported on CN88XX pass 1.x, and is always
	disabled. */
	//PCIE-ENHANCED-ALLOCATION = "1";

	/* Force CCPI lane reversal. This should be set for boards which
	reverse the CCPI lanes between nodes. If lane 0 connects to lane
	23, this option is needed. CN88XX pass 2.0 and higher automatically
	detect lane reversal, so setting this is optional.
	    0 = Automatically detect lane reversal, no lane reversal on
	        CN88XX pass 1.x.
	    1 = Force lane reversal, required on CN88XX pass 1.0 with CCPI
	        lanes reversed. */
	//CCPI-LANE-REVERSE = "0";

	/* Cavium SKU for the chip. This is determined by early code and
	passed to later software for display. This should not be set in
	the input device tree, it will be ignored. */
	//CHIP-SKU.NODE%d = "TBD";

	/* For Cavium evaluation boards, query the MCU for QLM setup
	information. The MCU supplies a TWSI protocol for the SOC to
	query the modules plugged in and automatically set the QLMs to
	the correct mode. This should only be enabled(1) on Cavium
	EBB8XXX boards. Other boards should have it disabled(0). */
	//QLM-AUTO-CONFIG = "0";

	/* Set the mode of a QLM. The possible mode strings are:
	    DISABLED
	    PCIE_1X1
	    PCIE_2X1
	    PCIE_1X2
	    PCIE_1X4
	    PCIE_1X8
	    SATA_4X1
	    SATA_2X1
	    ILK
	    SGMII_4X1
	    SGMII_2X1
	    XAUI_1X4
	    RXAUI_2X2
	    RXAUI_1X2
	    OCI
	    XFI_4X1
	    XFI_2X1
	    XLAUI_1X4
	    10G_KR_4X1
	    10G_KR_2X1
	    40G_KR4_1X4 */
	//QLM-MODE.N%d.QLM%d = "";
	QLM-MODE.N0.QLM0 = "XFI_4X1";
	QLM-MODE.N0.QLM1 = "XLAUI_1X4";
	QLM-MODE.N0.QLM2 = "PCIE_1X4";
	QLM-MODE.N0.QLM3 = "SATA_4X1";
	QLM-MODE.N0.QLM4 = "PCIE_1X8";
	QLM-MODE.N0.QLM6 = "PCIE_1X8";

	QLM-MODE.N1.QLM0 = "XFI_4X1";
	QLM-MODE.N1.QLM3 = "SATA_4X1";

	/* Set the speed of a QLM in Mhz. The possible speeds are:
	    1250
	    1500
	    2500
	    3000
	    3125
	    5000
	    6000
	    6250
	    8000
	   10312 */
	//QLM-FREQ.N%d.QLM%d = "0";
	QLM-FREQ.N0.QLM0 = "10312";
	QLM-FREQ.N0.QLM1 = "10312";
	QLM-FREQ.N0.QLM2 = "8000";
	QLM-FREQ.N0.QLM3 = "6000";
	QLM-FREQ.N0.QLM4 = "8000";
	QLM-FREQ.N0.QLM6 = "8000";

	QLM-FREQ.N1.QLM0 = "10312";
	QLM-FREQ.N1.QLM3 = "6000";

	/* Set the source of the QLM reference clock:
	    0 = Common clock 0
	    1 = Common clock 1
	    2 = QLM external reference */
	//QLM-CLK.N%d.QLM%d = "2";
	QLM-CLK.N0 = "0";
	QLM-CLK.N0.QLM0 = "2";
	QLM-CLK.N0.QLM1 = "2";

	QLM-CLK.N1 = "2";

	/* Setting of GSERX_LANEX_TX_CFG_0[CFG_TX_SWING] for the QLM. This
	should only be used for QLMs used for BGX and CCPI not using KR
	training. */
	//QLM-TUNING-TX-SWING.N%d.QLM%d.LANE%d = "-1";
	QLM-TUNING-TX-SWING.N0.QLM3 = "12";
	QLM-TUNING-TX-SWING.N0.QLM6 = "12";
	QLM-TUNING-TX-SWING.N0.QLM7 = "12";

	QLM-TUNING-TX-SWING.N1.QLM3 = "12";
	QLM-TUNING-TX-SWING.N1.QLM6 = "12";
	QLM-TUNING-TX-SWING.N1.QLM7 = "12";

	/* Setting of GSERX_LANEX_TX_PRE_EMPHASIS[CFG_TX_PREMPTAP] for the
	QLM. This should only be used for QLMs used for BGX and CCPI not
	using KR training. CFG_TX_PREMPTAP:
	    Bits[8:5] = Tx Post Tap; Bits[3:0] = Tx Pre Tap */
	//QLM-TUNING-TX-PREMPTAP.N%d.QLM%d.LANE%d = "-1";
	QLM-TUNING-TX-PREMPTAP.N0.QLM3 = "192";
	QLM-TUNING-TX-PREMPTAP.N0.QLM6 = "192";
	QLM-TUNING-TX-PREMPTAP.N0.QLM7 = "192";

	QLM-TUNING-TX-PREMPTAP.N1.QLM3 = "192";
	QLM-TUNING-TX-PREMPTAP.N1.QLM6 = "192";
	QLM-TUNING-TX-PREMPTAP.N1.QLM7 = "192";

	/* Setting of GSERX_LANEX_TX_CFG_3[PCS_SDS_TX_GAIN] for the QLM. This
	should only be used for QLMs used for BGX and CCPI not using KR
	training. */
	//QLM-TUNING-TX-GAIN.N%d.QLM%d.LANE%d = "-1";

	/* Setting of GSERX_LANEX_TX_CFG_3[CFG_TX_VBOOST_EN] for the QLM. This
	should only be used for QLMs used for BGX and CCPI not using KR
	training. */
	//QLM-TUNING-TX-VBOOST.N%d.QLM%d.LANE%d = "-1";

	/* Speed grade to use for DRAM in MT/s. Hardware may adjust this value
	slightly to improve DRAM stability, so scope measurements may not
	exactly match the frequency with MT/s. The Cavium supported speed
	grades are:
	    666 MT/s
	    800 MT/s
	    1066 MT/s
	    1333 MT/s
	    1600 MT/s
	    1866 MT/s
	    2133 MT/s (DDR4 only)
	Parameters:
	    N#: Parameter can be different for each node. This specifies
	        which node the value is for. Node must be 0-3. Optional. */
	//DDR-SPEED.N%d = "0";
	DDR-SPEED = "1866";

	/* Set to use a an alternate reference clock for DRAM than the usual
	50Mhz reference. The value of here specifies the frequency of the
	alternate clock in Mhz. Currently the only supported reference
	clock frequencies are 50Mhz and 100Mhz.
	Parameters:
	    N#: Parameter can be different for each node. This specifies
	        which node the value is for. Node must be 0-3. Optional. */
	//DDR-ALT-REFCLK.N%d = "0";
	DDR-ALT-REFCLK = "0";

	/* TWSI address of the DIMM SPD. The encoding of this address is
	:    [15:12]: TWSI bus the DIMM is connected to.
	     [11:7]: Reserved, set to zero.
	      [6:0]: TWSI address for the DIMM.
	A value of zero means the DIMMs are not accessible. Hard coded
	values will be read from DDR-CONFIG-SPD-DATA.Parameters:
	    LMC#: Parameter can be different for memory controller. This
	        specifies which LMC the value is for. LMC must be
	        0-3. Optional.
	    N#: Parameter can be different for each node. This specifies
	        which node the value is for. Node must be 0-3. Optional. */
	//DDR-CONFIG-SPD-ADDR.DIMM%d.LMC%d.N%d = "0";
	DDR-CONFIG-SPD-ADDR.DIMM0.LMC3.N1 = "0x2053";
	DDR-CONFIG-SPD-ADDR.DIMM0.LMC2.N1 = "0x2052";
	DDR-CONFIG-SPD-ADDR.DIMM0.LMC1.N1 = "0x2051";
	DDR-CONFIG-SPD-ADDR.DIMM0.LMC0.N1 = "0x2050";
	DDR-CONFIG-SPD-ADDR.DIMM0.LMC3.N0 = "0x2053";
	DDR-CONFIG-SPD-ADDR.DIMM0.LMC2.N0 = "0x2052";
	DDR-CONFIG-SPD-ADDR.DIMM0.LMC1.N0 = "0x2051";
	DDR-CONFIG-SPD-ADDR.DIMM0.LMC0.N0 = "0x2050";

	/* RTT_NOM per rank. LMC writes this value to MR1[RTT_NOM] in the
	rank (i.e. DIMM0_CS0) DDR3 parts when selected during
	power-up/init, write-leveling, and, if LMC()_CONFIG[SREF_WITH_DLL]
	is set, self-refresh entry and exit instruction sequences. See
	LMC()_SEQ_CTL[SEQ_SEL,INIT_START] and LMC()_CONFIG[RANKMASK] and
	LMC()_RESET_CTL[DDR3PWARM, DDR3PSOFT]. Per JEDEC DDR3
	specifications, if RTT_NOM is used during write operations, only
	values MR1[RTT_NOM] = 1 (RZQ/4), 2 (RZQ/2), or 3 (RZQ/6) are
	allowed. Otherwise, values MR1[RTT_NOM] = 4 (RZQ/12) and 5 (RZQ/8)
	are also allowed.
	Parameters:
	    RANKS#: Specifies that this parameter only applies to DIMMs
	        with the supplied number of ranks. Support ranks is 1, 2,
	        or 4. Optional.
	    DIMMS#: Specifies that this parameter only applies when the
	        DIMMs per memory controller matches. Support number of
	        DIMMs is 1 or 2. Optional.
	    RANK#: Parameter can be different for each rank of a DIMM. This
	        specifies which rank the value is for. Rank must be
	        0-3. Optional.
	    LMC#: Parameter can be different for memory controller. This
	        specifies which LMC the value is for. LMC must be
	        0-3. Optional.
	    N#: Parameter can be different for each node. This specifies
	        which node the value is for. Node must be 0-3. Optional. */
	//DDR-CONFIG-MODE1-RTT-NOM.RANKS%d.DIMMS%d.RANK%d.LMC%d.N%d = "0";
	DDR-CONFIG-MODE1-RTT-NOM.RANKS2.DIMMS2.RANK3.LMC3 = "0x2";
	DDR-CONFIG-MODE1-RTT-NOM.RANKS2.DIMMS2.RANK2.LMC3 = "0x2";
	DDR-CONFIG-MODE1-RTT-NOM.RANKS2.DIMMS2.RANK1.LMC3 = "0x2";
	DDR-CONFIG-MODE1-RTT-NOM.RANKS2.DIMMS2.RANK0.LMC3 = "0x2";
	DDR-CONFIG-MODE1-RTT-NOM.RANKS4.DIMMS1.RANK2.LMC3 = "0x4";
	DDR-CONFIG-MODE1-RTT-NOM.RANKS4.DIMMS1.RANK0.LMC3 = "0x4";
	DDR-CONFIG-MODE1-RTT-NOM.RANKS2.DIMMS2.RANK3.LMC2 = "0x2";
	DDR-CONFIG-MODE1-RTT-NOM.RANKS2.DIMMS2.RANK2.LMC2 = "0x2";
	DDR-CONFIG-MODE1-RTT-NOM.RANKS2.DIMMS2.RANK1.LMC2 = "0x2";
	DDR-CONFIG-MODE1-RTT-NOM.RANKS2.DIMMS2.RANK0.LMC2 = "0x2";
	DDR-CONFIG-MODE1-RTT-NOM.RANKS4.DIMMS1.RANK2.LMC2 = "0x4";
	DDR-CONFIG-MODE1-RTT-NOM.RANKS4.DIMMS1.RANK0.LMC2 = "0x4";
	DDR-CONFIG-MODE1-RTT-NOM.RANKS2.DIMMS2.RANK3.LMC1 = "0x2";
	DDR-CONFIG-MODE1-RTT-NOM.RANKS2.DIMMS2.RANK2.LMC1 = "0x2";
	DDR-CONFIG-MODE1-RTT-NOM.RANKS2.DIMMS2.RANK1.LMC1 = "0x2";
	DDR-CONFIG-MODE1-RTT-NOM.RANKS2.DIMMS2.RANK0.LMC1 = "0x2";
	DDR-CONFIG-MODE1-RTT-NOM.RANKS4.DIMMS1.RANK2.LMC1 = "0x4";
	DDR-CONFIG-MODE1-RTT-NOM.RANKS4.DIMMS1.RANK0.LMC1 = "0x4";
	DDR-CONFIG-MODE1-RTT-NOM.RANKS2.DIMMS2.RANK3.LMC0 = "0x2";
	DDR-CONFIG-MODE1-RTT-NOM.RANKS2.DIMMS2.RANK2.LMC0 = "0x2";
	DDR-CONFIG-MODE1-RTT-NOM.RANKS2.DIMMS2.RANK1.LMC0 = "0x2";
	DDR-CONFIG-MODE1-RTT-NOM.RANKS2.DIMMS2.RANK0.LMC0 = "0x2";
	DDR-CONFIG-MODE1-RTT-NOM.RANKS4.DIMMS1.RANK2.LMC0 = "0x4";
	DDR-CONFIG-MODE1-RTT-NOM.RANKS4.DIMMS1.RANK0.LMC0 = "0x4";

	/* RTT park value per rank.
	Parameters:
	    RANKS#: Specifies that this parameter only applies to DIMMs
	        with the supplied number of ranks. Support ranks is 1, 2,
	        or 4. Optional.
	    DIMMS#: Specifies that this parameter only applies when the
	        DIMMs per memory controller matches. Support number of
	        DIMMs is 1 or 2. Optional.
	    RANK#: Parameter can be different for each rank of a DIMM. This
	        specifies which rank the value is for. Rank must be
	        0-3. Optional.
	    LMC#: Parameter can be different for memory controller. This
	        specifies which LMC the value is for. LMC must be
	        0-3. Optional.
	    N#: Parameter can be different for each node. This specifies
	        which node the value is for. Node must be 0-3. Optional. */
	//DDR-CONFIG-MODE2-RTT-PARK.RANKS%d.DIMMS%d.RANK%d.LMC%d.N%d = "0";
	DDR-CONFIG-MODE2-RTT-PARK.RANKS2.DIMMS2.RANK3.LMC3 = "0x1";
	DDR-CONFIG-MODE2-RTT-PARK.RANKS2.DIMMS2.RANK2.LMC3 = "0x1";
	DDR-CONFIG-MODE2-RTT-PARK.RANKS2.DIMMS2.RANK1.LMC3 = "0x1";
	DDR-CONFIG-MODE2-RTT-PARK.RANKS2.DIMMS2.RANK0.LMC3 = "0x1";
	DDR-CONFIG-MODE2-RTT-PARK.RANKS1.DIMMS2.RANK2.LMC3 = "0x7";
	DDR-CONFIG-MODE2-RTT-PARK.RANKS1.DIMMS2.RANK0.LMC3 = "0x7";
	DDR-CONFIG-MODE2-RTT-PARK.RANKS4.DIMMS1.RANK1.LMC3 = "0x6";
	DDR-CONFIG-MODE2-RTT-PARK.RANKS4.DIMMS1.RANK0.LMC3 = "0x6";
	DDR-CONFIG-MODE2-RTT-PARK.RANKS2.DIMMS1.RANK1.LMC3 = "0x2";
	DDR-CONFIG-MODE2-RTT-PARK.RANKS2.DIMMS1.RANK0.LMC3 = "0x2";
	DDR-CONFIG-MODE2-RTT-PARK.RANKS1.DIMMS1.RANK0.LMC3 = "0x1";
	DDR-CONFIG-MODE2-RTT-PARK.RANKS2.DIMMS2.RANK3.LMC2 = "0x1";
	DDR-CONFIG-MODE2-RTT-PARK.RANKS2.DIMMS2.RANK2.LMC2 = "0x1";
	DDR-CONFIG-MODE2-RTT-PARK.RANKS2.DIMMS2.RANK1.LMC2 = "0x1";
	DDR-CONFIG-MODE2-RTT-PARK.RANKS2.DIMMS2.RANK0.LMC2 = "0x1";
	DDR-CONFIG-MODE2-RTT-PARK.RANKS1.DIMMS2.RANK2.LMC2 = "0x7";
	DDR-CONFIG-MODE2-RTT-PARK.RANKS1.DIMMS2.RANK0.LMC2 = "0x7";
	DDR-CONFIG-MODE2-RTT-PARK.RANKS4.DIMMS1.RANK1.LMC2 = "0x6";
	DDR-CONFIG-MODE2-RTT-PARK.RANKS4.DIMMS1.RANK0.LMC2 = "0x6";
	DDR-CONFIG-MODE2-RTT-PARK.RANKS2.DIMMS1.RANK1.LMC2 = "0x2";
	DDR-CONFIG-MODE2-RTT-PARK.RANKS2.DIMMS1.RANK0.LMC2 = "0x2";
	DDR-CONFIG-MODE2-RTT-PARK.RANKS1.DIMMS1.RANK0.LMC2 = "0x1";
	DDR-CONFIG-MODE2-RTT-PARK.RANKS2.DIMMS2.RANK3.LMC1 = "0x1";
	DDR-CONFIG-MODE2-RTT-PARK.RANKS2.DIMMS2.RANK2.LMC1 = "0x1";
	DDR-CONFIG-MODE2-RTT-PARK.RANKS2.DIMMS2.RANK1.LMC1 = "0x1";
	DDR-CONFIG-MODE2-RTT-PARK.RANKS2.DIMMS2.RANK0.LMC1 = "0x1";
	DDR-CONFIG-MODE2-RTT-PARK.RANKS1.DIMMS2.RANK2.LMC1 = "0x7";
	DDR-CONFIG-MODE2-RTT-PARK.RANKS1.DIMMS2.RANK0.LMC1 = "0x7";
	DDR-CONFIG-MODE2-RTT-PARK.RANKS4.DIMMS1.RANK1.LMC1 = "0x6";
	DDR-CONFIG-MODE2-RTT-PARK.RANKS4.DIMMS1.RANK0.LMC1 = "0x6";
	DDR-CONFIG-MODE2-RTT-PARK.RANKS2.DIMMS1.RANK1.LMC1 = "0x2";
	DDR-CONFIG-MODE2-RTT-PARK.RANKS2.DIMMS1.RANK0.LMC1 = "0x2";
	DDR-CONFIG-MODE2-RTT-PARK.RANKS1.DIMMS1.RANK0.LMC1 = "0x1";
	DDR-CONFIG-MODE2-RTT-PARK.RANKS2.DIMMS2.RANK3.LMC0 = "0x1";
	DDR-CONFIG-MODE2-RTT-PARK.RANKS2.DIMMS2.RANK2.LMC0 = "0x1";
	DDR-CONFIG-MODE2-RTT-PARK.RANKS2.DIMMS2.RANK1.LMC0 = "0x1";
	DDR-CONFIG-MODE2-RTT-PARK.RANKS2.DIMMS2.RANK0.LMC0 = "0x1";
	DDR-CONFIG-MODE2-RTT-PARK.RANKS1.DIMMS2.RANK2.LMC0 = "0x7";
	DDR-CONFIG-MODE2-RTT-PARK.RANKS1.DIMMS2.RANK0.LMC0 = "0x7";
	DDR-CONFIG-MODE2-RTT-PARK.RANKS4.DIMMS1.RANK1.LMC0 = "0x6";
	DDR-CONFIG-MODE2-RTT-PARK.RANKS4.DIMMS1.RANK0.LMC0 = "0x6";
	DDR-CONFIG-MODE2-RTT-PARK.RANKS2.DIMMS1.RANK1.LMC0 = "0x2";
	DDR-CONFIG-MODE2-RTT-PARK.RANKS2.DIMMS1.RANK0.LMC0 = "0x2";
	DDR-CONFIG-MODE2-RTT-PARK.RANKS1.DIMMS1.RANK0.LMC0 = "0x1";


	/* Run a short DRAM test after DRAM is initialized as quick check
	for functionality. This is normally not needed required. Boards
	with poor DRAM power supplies may use this to detect failures
	during boot. This should be used in combination with the watchdog
	timer. */
	//DDR-TEST-BOOT = "0";

	/* The DRAM initialization code has the ability to toggle a GPIO to
	signal when it is running. Boards may need to mux TWSI access
	between a BMC and the SOC so the BMC can monitor DIMM temperatures
	and health. This GPIO will be driven high when the SOC may read
	from the SPDs on the DIMMs. When driven low, another device (BMC)
	may takeover the TWSI connections to the DIMMS. The default value
	(-1) disables this feature. */
	//DDR-CONFIG-GPIO = "-1";

	/* Specify a on-chip GPIO used to control power for a USB port. When
	set, the USB host controller will toggle the GPIO automatically
	during USB reset events. The default value assumes the SOC has no
	control of the USB power and it is always on. */
	//USB-PWR-GPIO.N%d.PORT%d = "-1";
	USB-PWR-GPIO = "38";

	/* Specify the polarity of a on-chip GPIO used to control power for
	a USB port. The GPIO used is specified by USB-PWR-GPIO. Setting this
	GPIO low. The default value drives the GPIO high. */
	//USB-PWR-GPIO-POLARITY.N%d.PORT%d = "1";

	/* Number of reading with no errors to signal the start of an
	eye. The default value should be good for most cases. */
	//QLM-EYE-NUM-ZEROS = "2";

	/* Time to sample at each location in microseconds. The default
	value should be good for most cases. */
	//QLM-EYE-SAMPLE-TIME = "0x190";

	/* Time to settle after each movement in microseconds. The
	default value should be good for most cases. */
	//QLM-EYE-SETTLE-TIME = "0x32";

	/* Reference clock in Hz. CN88XX drives data on rising edges of this
	clock, and the target latches data on the falling edges of this
	clock. On reset CN88XX tristates SGPIO_SCLK. When not exchanging
	a bit stream CN88XX keeps SGPIO_SCLK low.
	  Min: 128 Hz
	  Max: 100 kHz */
	//SGPIO-SCLOCK-FREQ.N%d = "0x2710";

	/* Output pin number for SGPIO controller power control. */
	//SGPIO-PIN-POWER.N%d = "-1";

	/* Output pin number for SGPIO SCLOCK signal. */
	//SGPIO-PIN-SCLOCK.N%d = "-1";

	/* Output pin number for SGPIO SLOAD signal. */
	//SGPIO-PIN-SLOAD.N%d = "-1";

	/* Output pin number for SGPIO SDATAOUT[n] signal. n = 0..3. */
	//SGPIO-PIN-SDATAOUT.N%d.D%d = "-1";

	/* Temperature where THERMAL_TRIP_N is asserted. When the chip reaches
	this temperature THERMAL_TRIP_N will assert, signalling the board
	to emergency power off. The default value is the Cavium recommended
	maximum temperature of the chip. Values between 0 and 110 degrees
	Celsius. */
	//VRM-TEMP-TRIP.N%d = "0x6e";

	/* Temperature where maximum throttling is applied to the chip. Chip
	performance will be greatly reduced to keep the temperature below
	thermal trip (VRM-TEMP-TRIP). The default value is the Cavium
	recommended maximum operating temperature of the chip. Values
	between 0 and 110 degrees Celsius. */
	//VRM-TEMP-HIGH.N%d = "0x60";

	/* Temperature where minimum throttling is applied to the chip. Chip
	performance will be maximized at or below this temperature. The
	throttling level will be set to VRM-THROTTLE-NORMAL. The default
	value is the Cavium recommended operating temperature of the chip.
	Values between 0 and 110 degrees Celsius. */
	//VRM-TEMP-LOW.N%d = "0x5e";

	/* Throttle level of the chip when operating normally. Temperatures
	at or below VRM-TEMP-LOW will use this throttling level. The default
	level (70%), allows good performance while still reducing power under
	heavy loads. Value is a percentage between 1 and 100. */
	//VRM-THROTTLE-NORMAL.N%d = "0x46";

	/* Throttle level of the chip is overheating. Temperatures at or
	above VRM-TEMP-HIGH will use this throttling level. The default
	level (5%), allows for forward progress while still reducing power.
	Value is a percentage between 1 and 100. Setting a value of 100
	disables dynamic throttling (not recommended). */
	//VRM-THROTTLE-THERM.N%d = "5";

	/**********************************************************************
	 * The entries below are currently not used by the BDK. They are being
	 * used only by ATF / UEFI.
	 *
	 * Format for TWSI configuration:
	 *   TWSI-VAR-NAME = 0x01050E
	 *                     ||||||
	 *                     ||||++-- TWSI address
	 *                     ||++---- TWSI bus
	 *                     ++------ Node ID (0xFF = local node)
	 *
	 * Format for GPIO configuration:
	 *   GPIO-VAR-NAME = 0x01001A
	 *                     ||||||
	 *                     ||||++-- GPIO Number
	 *                     |||+---- GPIO polarity (0=normal, 1=inverted)
	 *                     ||+----- GPIO type (0=level, 1=edge)
	 *                     ++------ Node ID (0xFF = local node)
	 *
	 **********************************************************************/

	/* TWSI bus and address for Boot Status information to BMC. */
	//BMC-BOOT-TWSI-CONFIG = "-1";
	BMC-BOOT-TWSI-CONFIG = "0x000120";

	/* TWSI bus and address for IPMI communication to BMC
	   -1 =  No connection exists  */
	//BMC-IPMI-TWSI-CONFIG = "-1";
	BMC-IPMI-TWSI-CONFIG = "0x000512";

	/* GPIO pin connected to board power button */
	//GPIO-SHUTDOWN-CTL-IN = "-1";
	GPIO-SHUTDOWN-CTL-IN = "0x001011";

	/* GPIO pin to CPLD-BMC from SOC to inform host initiated shutdown */
	//GPIO-SHUTDOWN-CTL-OUT = "-1";
	GPIO-SHUTDOWN-CTL-OUT = "0x000010";

	/* RTC connection over TWSI bus of SOC.
	   -1 =  No connection exists  */
	//RTC-TWSI-CONFIG = "-1";
	RTC-TWSI-CONFIG = "0x000068";

	/* SGPIO configuration (Connector P1) */
	SGPIO-SCLOCK-FREQ = "10000";
	SGPIO-PIN-POWER = "29";
	SGPIO-PIN-SCLOCK = "26";
	SGPIO-PIN-SLOAD = "28";
	SGPIO-PIN-SDATAOUT.N0.D0 = "27";
}; /* cavium,bdk */
}; /* / */
