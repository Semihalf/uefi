/dts-v1/;

/ {
cavium,bdk {
	/* THUNDERX TWSI port connected to the BMC for IPMI traffic.
	-1 = No connection exists. 0+ is TWSI bus number. */
	//BMC-TWSI = "-1";

	/* This specifies a watchdog timer should run during boot and reset
	the chip if boot hangs for some reason. The timeout is specified
	in milliseconds. Zero disables the watchdog. */
	//WATCHDOG-TIMEOUT = "0";

	/* Allow a sequence of TWSI writes to be performed during boot. Each
	string in the list line is executed in sequence. The TWSI write
	format is:
	    node,twsi_id,dev_addr,internal_addr,num_bytes,ia_width_bytes,data
	    sleep,ms
	node           = THUNDERX node ID the twsi bus is on. -1 means the local node
	twsi_id        = THUNDERX twsi bus to use
	dev_addr       = TWSI bus address
	internal_addr  = TWSI internal address, zero if not used
	num_bytes      = Number of bytes to write (1-8)
	ia_width_bytes = Internal address width in bytes (0-2)
	data           = Data to write as a 64bit number
	sleep,ms       = This on a line delays for 'ms' milliseconds */
	//TWSI-WRITE = "";

	/* Allow a sequence of MDIO writes to be performed during boot. Each
	string in the list line is executed in sequence. The MDIO write
	format is:
	    clause,node,bus_id,phy_id,device,location,val
	    sleep,ms
	clause   = MDIO clause for the write (22 or 45)
	node     = THUNDERX node the MDIO bus is connected, -1 for local
	bus_id   = THUNDERX MDIO bus to use
	phy_id   = MDIO address
	device   = Clause 45 internal device address, zero for clause 22
	location = MDIO register
	val      = Value to write
	sleep,ms = This on a line delays for 'ms' milliseconds */
	//MDIO-WRITE = "";

	/* PHY address encoding:
	    Bits[31:24]: Node ID, 0xff for node the ethernet device is on
	    Bits[23:16]: Only used for TWSI
	    Bits[15:12]: PHY connection type (0=MDIO, 1=Fixed, 2=TWSI)
	For MDIO:
	    Bits[31:24]: Node ID, 0xff for node the ethernet device is on
	    Bits[23:16]: 0
	    Bits[15:12]: 0=MDIO
	    Bits[11:8]: MDIO bus number
	    Bits[7:0]: MDIO address
	For Fixed:
	    Bits[31:24]: 0
	    Bits[23:16]: Zero
	    Bits[15:12]: 1=Fixed
	    Bits[11:0]:  0 = 1Gb, 1 = 100Mb
	For TWSI:
	    Bits[31:24]: Node ID, 0xff for node the ethernet device is on
	    Bits[23:16]: TWSI internal address width in bytes (0-2)
	    Bits[15:12]: 2=TWSI
	    Bits[11:8]: TWSI bus number
	    Bits[7:0]: TWSI address */
	//PHY-ADDRESS.N%d.BGX%d.P%d = "-1";
	// When board is running as Node 0
	// BGX0 (QLM0) PHY addresses
	PHY-ADDRESS.N0.BGX0.P0 = "0xff000000";
	PHY-ADDRESS.N0.BGX0.P1 = "0xff000001";
	PHY-ADDRESS.N0.BGX0.P2 = "0xff000002";
	PHY-ADDRESS.N0.BGX0.P3 = "0xff000003";
	// BGX1 (QLM1) PHY addresses
	PHY-ADDRESS.N0.BGX1.P0 = "0xff000104";
	PHY-ADDRESS.N0.BGX1.P1 = "0xff000105";
	PHY-ADDRESS.N0.BGX1.P2 = "0xff000106";
	PHY-ADDRESS.N0.BGX1.P3 = "0xff000107";

	// When board is running as Node 1
	// BGX0 (QLM0) PHY addresses
	PHY-ADDRESS.N1.BGX0.P0 = "0xff000000";
	PHY-ADDRESS.N1.BGX0.P1 = "0xff000001";
	PHY-ADDRESS.N1.BGX0.P2 = "0xff000002";
	PHY-ADDRESS.N1.BGX0.P3 = "0xff000003";
	// BGX1 (QLM1) PHY addresses
	PHY-ADDRESS.N1.BGX1.P0 = "0xff000104";
	PHY-ADDRESS.N1.BGX1.P1 = "0xff000105";
	PHY-ADDRESS.N1.BGX1.P2 = "0xff000106";
	PHY-ADDRESS.N1.BGX1.P3 = "0xff000107";

	/* Independent enables for each BGX port of THUNDERX. Use this to
	disable ports that are not wired on a board. Default is that all
	ports are enabled. */
	//BGX-ENABLE.N%d.BGX%d.P%d = "1";

	/* Number of packet buffers in the BDK. */
	//BDK-NUM-PACKET-BUFFERS = "0x1000";

	/* The size of each packet buffer in the BDK. */
	//BDK-PACKET-BUFFER-SIZE = "0x400";

	/* Controls whether the BDK displays link status messages. */
	//BDK-SHOW-LINK-STATUS = "1";

	/* Controls the cores used by the BDK. Zero means all cores. */
	//BDK-COREMASK = "0";

	/* Timeout for the boot menu in seconds. */
	//BDK-BOOT-MENU-TIMEOUT = "0xa";

	/* This is used by the boot menu to control which boot path the init
	code chooses. The supported options are
	    0 = Normal boot path
	    1 = Diagnostics boot path */
	//BDK-BOOT-PATH-OPTION = "0";

	/* BDK trace level. This is a bitmask of the enumeration defined in
	bdk-trace.h. Each bit turns on tracing of a specific BDK
	component. */
	//BDK-CONFIG-TRACE = "0";

	/* Determine how multi-node is supported for this system:
	    0 = Multi-node is not supported
	    1 = Multi-node is supported and booting requires two nodes
	    2 = Multi-node is auto detected. Two nodes are used if
	        if available, otherwise fall back to single node. */
	//MULTI-NODE = "2";
	MULTI-NODE = "0";

	/* Determine if internal PCIe ECAMs support Enhanced Allocation(EA):
	    0 = Enhanced Allocation is not supported
	    1 = Enhanced Allocation is supported
	Note EA is not supported on CN88XX pass 1.x, and is always
	disabled. */
	//PCIE-ENHANCED-ALLOCATION = "1";
	PCIE-ENHANCED-ALLOCATION = "0";

	/* For Cavium evaluation boards, query the MCU for QLM setup
	information. The MCU supplies a TWSI protocol for THUNDERX to
	query the modules plugged in and automatically set the QLMs to
	the correct mode. This should only be enabled(1) on Cavium
	EBB8XXX boards. Other boards should have it disabled(0). */
	//QLM-AUTO-CONFIG = "0";
	QLM-AUTO-CONFIG = "1";

	/* Set the mode of a QLM. The possible mode strings are:
	    DISABLED
	    PCIE_1X1
	    PCIE_2X1
	    PCIE_1X2
	    PCIE_1X4
	    PCIE_1X8
	    SATA_4X1
	    SATA_2X1
	    ILK
	    SGMII_4X1
	    SGMII_2X1
	    XAUI_1X4
	    RXAUI_2X2
	    RXAUI_1X2
	    OCI
	    XFI_4X1
	    XFI_2X1
	    XLAUI_1X4
	    10G_KR_4X1
	    10G_KR_2X1
	    40G_KR4_1X4 */
	//QLM-MODE.N%d.QLM%d = "";

	/* Set the speed of a QLM in Mhz. The possible speeds are:
	    1250
	    1500
	    2500
	    3000
	    3125
	    5000
	    6000
	    6250
	    8000
	   10312 */
	//QLM-FREQ.N%d.QLM%d = "0";

	/* Set the source of the QLM reference clock:
	    0 = Common clock 0
	    1 = Common clock 1
	    2 = QLM external reference */
	//QLM-CLK.N%d.QLM%d = "2";

	/* Setting of GSERX_LANEX_TX_CFG_0[CFG_TX_SWING] for the QLM. This
	should only be used for QLMs used for BGX and CCPI not using KR
	training. */
	//QLM-TUNING-TX-SWING.N%d.QLM%d.LANE%d = "-1";

	/* Setting of GSERX_LANEX_TX_PRE_EMPHASIS[CFG_TX_PREMPTAP] for the
	QLM. This should only be used for QLMs used for BGX and CCPI not
	using KR training. CFG_TX_PREMPTAP:
	    Bits[8:5] = Tx Post Tap; Bits[3:0] = Tx Pre Tap */
	//QLM-TUNING-TX-PREMPTAP.N%d.QLM%d.LANE%d = "-1";

	/* Setting of GSERX_LANEX_TX_CFG_3[PCS_SDS_TX_GAIN] for the QLM. This
	should only be used for QLMs used for BGX and CCPI not using KR
	training. */
	//QLM-TUNING-TX-GAIN.N%d.QLM%d.LANE%d = "-1";

	/* Setting of GSERX_LANEX_TX_CFG_3[CFG_TX_VBOOST_EN] for the QLM. This
	should only be used for QLMs used for BGX and CCPI not using KR
	training. */
	//QLM-TUNING-TX-VBOOST.N%d.QLM%d.LANE%d = "-1";

	/* Deprecated: DRAM configuration name to use for the board. This
	corresponds to a file in lib-dram/configs/config-*.c. Boards should
	configure DRAM using the board device tree. This is only present
	for boards that have not been converted to device tree yet. This
	option will be removed in the future
	Parameters:
	    N#: Parameter can be different for each node. This specifies
	        which node the value is for. Node must be 0-3. Optional. */
	//DDR-CONFIG.N%d = "";
	DDR-CONFIG = "ebb8804";

	/* Speed to use for DRAM in MT/s. Zero means use the factory
	default. Hardware may adjust this value slightly to improve
	DRAM stability, so scope measurements may not exactly match
	the frequency with MT/s.
	Parameters:
	    N#: Parameter can be different for each node. This specifies
	        which node the value is for. Node must be 0-3. Optional. */
	//DDR-SPEED.N%d = "0";
	DDR-SPEED.N0 = "1866";

	/* Set to use a an alternate reference clock for DRAM than the usual
	50Mhz reference. The value of here specifies the frequency of the
	alternate clock in Mhz. Currently the only supported reference
	clock frequencies are 50Mhz and 100Mhz.
	Parameters:
	    N#: Parameter can be different for each node. This specifies
	        which node the value is for. Node must be 0-3. Optional. */
	//DDR-ALT-REFCLK.N%d = "0";

	/* TWSI address of the DIMM SPD. The encoding of this address is
	:    [15:12]: TWSI bus the DIMM is connected to.
	     [11:7]: Reserved, set to zero.
	      [6:0]: TWSI address for the DIMM.
	A value of zero means the DIMMs are not accessible. Hard coded
	values will be read from DDR-CONFIG-SPD-DATA.Parameters:
	    LMC#: Parameter can be different for memory controller. This
	        specifies which LMC the value is for. LMC must be
	        0-3. Optional.
	    N#: Parameter can be different for each node. This specifies
	        which node the value is for. Node must be 0-3. Optional. */
	//DDR-CONFIG-SPD-ADDR.DIMM%d.LMC%d.N%d = "0";
	DDR-CONFIG-SPD-ADDR.DIMM1.LMC3.N0 = "0x1057";
	DDR-CONFIG-SPD-ADDR.DIMM0.LMC3.N0 = "0x1056";
	DDR-CONFIG-SPD-ADDR.DIMM1.LMC2.N0 = "0x1055";
	DDR-CONFIG-SPD-ADDR.DIMM0.LMC2.N0 = "0x1054";
	DDR-CONFIG-SPD-ADDR.DIMM1.LMC1.N0 = "0x1053";
	DDR-CONFIG-SPD-ADDR.DIMM0.LMC1.N0 = "0x1052";
	DDR-CONFIG-SPD-ADDR.DIMM1.LMC0.N0 = "0x1051";
	DDR-CONFIG-SPD-ADDR.DIMM0.LMC0.N0 = "0x1050";

	/* DIMM SPD data to be used if memory doesn't support the standard
	TWSI access to DIMM SPDs. The format of this is a binary blob
	stored in the device tree. An example would be:
	Parameters:
	    LMC#: Parameter can be different for memory controller. This
	        specifies which LMC the value is for. LMC must be
	        0-3. Optional.
	    N#: Parameter can be different for each node. This specifies
	        which node the value is for. Node must be 0-3. Optional. */
	//DDR-CONFIG-SPD-DATA.DIMM%d.LMC%d.N%d = "";

	/* Drive strength control for DDR_DQ* / DDR_DQS_*_P/N drivers.
	    0x1 = 24 ohm.
	    0x2 = 26.67 ohm.
	    0x3 = 30 ohm.
	    0x4 = 34.3 ohm.
	    0x5 = 40 ohm.
	    0x6 = 48 ohm.
	    0x7 = 60 ohm.
	    _ else = Reserved.
	Parameters:
	    RANKS#: Specifies that this parameter only applies to DIMMs
	        with the supplied number of ranks. Support ranks is 1, 2,
	        or 4. Optional.
	    DIMMS#: Specifies that this parameter only applies when the
	        DIMMs per memory controller matches. Support number of
	        DIMMs is 1 or 2. Optional.
	    LMC#: Parameter can be different for memory controller. This
	        specifies which LMC the value is for. LMC must be
	        0-3. Optional.
	    N#: Parameter can be different for each node. This specifies
	        which node the value is for. Node must be 0-3. Optional. */
	//DDR-CONFIG-DQX-CTL.RANKS%d.DIMMS%d.LMC%d.N%d = "0";
	DDR-CONFIG-DQX-CTL.RANKS2.DIMMS2.LMC3.N0 = "0x4";
	DDR-CONFIG-DQX-CTL.RANKS1.DIMMS2.LMC3.N0 = "0x4";
	DDR-CONFIG-DQX-CTL.RANKS4.DIMMS1.LMC3.N0 = "0x4";
	DDR-CONFIG-DQX-CTL.RANKS2.DIMMS1.LMC3.N0 = "0x4";
	DDR-CONFIG-DQX-CTL.RANKS1.DIMMS1.LMC3.N0 = "0x4";
	DDR-CONFIG-DQX-CTL.RANKS2.DIMMS2.LMC2.N0 = "0x4";
	DDR-CONFIG-DQX-CTL.RANKS1.DIMMS2.LMC2.N0 = "0x4";
	DDR-CONFIG-DQX-CTL.RANKS4.DIMMS1.LMC2.N0 = "0x4";
	DDR-CONFIG-DQX-CTL.RANKS2.DIMMS1.LMC2.N0 = "0x4";
	DDR-CONFIG-DQX-CTL.RANKS1.DIMMS1.LMC2.N0 = "0x4";
	DDR-CONFIG-DQX-CTL.RANKS2.DIMMS2.LMC1.N0 = "0x4";
	DDR-CONFIG-DQX-CTL.RANKS1.DIMMS2.LMC1.N0 = "0x4";
	DDR-CONFIG-DQX-CTL.RANKS4.DIMMS1.LMC1.N0 = "0x4";
	DDR-CONFIG-DQX-CTL.RANKS2.DIMMS1.LMC1.N0 = "0x4";
	DDR-CONFIG-DQX-CTL.RANKS1.DIMMS1.LMC1.N0 = "0x4";
	DDR-CONFIG-DQX-CTL.RANKS2.DIMMS2.LMC0.N0 = "0x4";
	DDR-CONFIG-DQX-CTL.RANKS1.DIMMS2.LMC0.N0 = "0x4";
	DDR-CONFIG-DQX-CTL.RANKS4.DIMMS1.LMC0.N0 = "0x4";
	DDR-CONFIG-DQX-CTL.RANKS2.DIMMS1.LMC0.N0 = "0x4";
	DDR-CONFIG-DQX-CTL.RANKS1.DIMMS1.LMC0.N0 = "0x4";

	/* LMC Write OnDieTermination Mask Register
	System designers may desire to terminate DQ/DQS lines for
	higher-frequency DDR operations, especially on a multirank system.
	DDR3 DQ/DQS I/Os have built-in termination resistors that can be
	turned on or off by the controller, after meeting TAOND and TAOF
	timing requirements. Each rank has its own ODT pin that fans out
	to all of the memory parts in that DIMM. System designers may
	prefer different combinations of ODT ONs for write operations into
	different ranks. CNXXXX supports full programmability by way of
	the mask register below. Each rank position has its own 8-bit
	programmable field. When the controller does a write to that rank,
	it sets the 4 ODT pins to the mask pins below. For example, when
	doing a write into Rank0, a system designer may desire to terminate
	the lines with the resistor on DIMM0/Rank1. The mask WODT_D0_R0
	would then be {00000010}.
	CNXXXX drives the appropriate mask values on the ODT pins by
	default. If this feature is not required, write 0x0 in this
	register. When a given RANK is selected, the WODT mask for that
	RANK is used.
	Parameters:
	    RANKS#: Specifies that this parameter only applies to DIMMs
	        with the supplied number of ranks. Support ranks is 1, 2,
	        or 4. Optional.
	    DIMMS#: Specifies that this parameter only applies when the
	        DIMMs per memory controller matches. Support number of
	        DIMMs is 1 or 2. Optional.
	    LMC#: Parameter can be different for memory controller. This
	        specifies which LMC the value is for. LMC must be
	        0-3. Optional.
	    N#: Parameter can be different for each node. This specifies
	        which node the value is for. Node must be 0-3. Optional. */
	//DDR-CONFIG-WODT-MASK.RANKS%d.DIMMS%d.LMC%d.N%d = "0";
	DDR-CONFIG-WODT-MASK.RANKS2.DIMMS2.LMC3.N0 = "0xc0c0303";
	DDR-CONFIG-WODT-MASK.RANKS4.DIMMS1.LMC3.N0 = "0x1030203";
	DDR-CONFIG-WODT-MASK.RANKS2.DIMMS2.LMC2.N0 = "0xc0c0303";
	DDR-CONFIG-WODT-MASK.RANKS4.DIMMS1.LMC2.N0 = "0x1030203";
	DDR-CONFIG-WODT-MASK.RANKS2.DIMMS2.LMC1.N0 = "0xc0c0303";
	DDR-CONFIG-WODT-MASK.RANKS4.DIMMS1.LMC1.N0 = "0x1030203";
	DDR-CONFIG-WODT-MASK.RANKS2.DIMMS2.LMC0.N0 = "0xc0c0303";
	DDR-CONFIG-WODT-MASK.RANKS4.DIMMS1.LMC0.N0 = "0x1030203";

	/* Partial array self-refresh per rank. LMC writes this value to
	MR2[PASR] in the rank (i.e. DIMM0_CS0) DDR3 parts when selected
	during power-up/init, write-leveling, and, if
	LMC()_CONFIG[SREF_WITH_DLL] is set, self-refresh entry and exit
	instruction sequences. See LMC()_SEQ_CTL[SEQ_SEL,INIT_START] and
	LMC()_CONFIG[RANKMASK] and LMC()_RESET_CTL[DDR3PWARM,DDR3PSOFT].
	Parameters:
	    RANKS#: Specifies that this parameter only applies to DIMMs
	        with the supplied number of ranks. Support ranks is 1, 2,
	        or 4. Optional.
	    DIMMS#: Specifies that this parameter only applies when the
	        DIMMs per memory controller matches. Support number of
	        DIMMs is 1 or 2. Optional.
	    RANK#: Parameter can be different for each rank of a DIMM. This
	        specifies which rank the value is for. Rank must be
	        0-3. Optional.
	    LMC#: Parameter can be different for memory controller. This
	        specifies which LMC the value is for. LMC must be
	        0-3. Optional.
	    N#: Parameter can be different for each node. This specifies
	        which node the value is for. Node must be 0-3. Optional. */
	//DDR-CONFIG-MODE1-PASR.RANKS%d.DIMMS%d.RANK%d.LMC%d.N%d = "0";

	/* Auto self-refresh per rank. LMC writes this value to MR2[ASR] in
	the rank (i.e. DIMM0_CS0) DDR3 parts when selected during
	power-up/init, write-leveling, and, if LMC()_CONFIG[SREF_WITH_DLL]
	is set, self-refresh entry and exit instruction sequences. See
	LMC()_SEQ_CTL[SEQ_SEL,INIT_START] and LMC()_CONFIG[RANKMASK] and
	LMC()_RESET_CTL [DDR3PWARM,DDR3PSOFT].
	Parameters:
	    RANKS#: Specifies that this parameter only applies to DIMMs
	        with the supplied number of ranks. Support ranks is 1, 2,
	        or 4. Optional.
	    DIMMS#: Specifies that this parameter only applies when the
	        DIMMs per memory controller matches. Support number of
	        DIMMs is 1 or 2. Optional.
	    RANK#: Parameter can be different for each rank of a DIMM. This
	        specifies which rank the value is for. Rank must be
	        0-3. Optional.
	    LMC#: Parameter can be different for memory controller. This
	        specifies which LMC the value is for. LMC must be
	        0-3. Optional.
	    N#: Parameter can be different for each node. This specifies
	        which node the value is for. Node must be 0-3. Optional. */
	//DDR-CONFIG-MODE1-ASR.RANKS%d.DIMMS%d.RANK%d.LMC%d.N%d = "0";

	/* Self-refresh temperature range per rank. LMC writes this value to
	MR2[SRT] in the rank (i.e. DIMM0_CS0) DDR3 parts when selected
	during power-up/init, write-leveling, and, if
	LMC()_CONFIG[SREF_WITH_DLL] is set, self-refresh entry and exit
	instruction sequences. See LMC()_SEQ_CTL[SEQ_SEL,INIT_START] and
	LMC()_CONFIG[RANKMASK] and LMC()_RESET_CTL[DDR3PWARM,DDR3PSOFT].
	Parameters:
	    RANKS#: Specifies that this parameter only applies to DIMMs
	        with the supplied number of ranks. Support ranks is 1, 2,
	        or 4. Optional.
	    DIMMS#: Specifies that this parameter only applies when the
	        DIMMs per memory controller matches. Support number of
	        DIMMs is 1 or 2. Optional.
	    RANK#: Parameter can be different for each rank of a DIMM. This
	        specifies which rank the value is for. Rank must be
	        0-3. Optional.
	    LMC#: Parameter can be different for memory controller. This
	        specifies which LMC the value is for. LMC must be
	        0-3. Optional.
	    N#: Parameter can be different for each node. This specifies
	        which node the value is for. Node must be 0-3. Optional. */
	//DDR-CONFIG-MODE1-SRT.RANKS%d.DIMMS%d.RANK%d.LMC%d.N%d = "0";

	/* RTT_WR per rank. LMC writes this value to MR2[RTT_WR] in the rank
	(i.e. DIMM0_CS0) DDR3 parts when selected during power-up/init,
	write-leveling, and, if LMC()_CONFIG[SREF_WITH_DLL] is set,
	self-refresh entry and exit instruction sequences. See
	LMC()_SEQ_CTL[SEQ_SEL,INIT_START] and LMC()_CONFIG[RANKMASK] and
	LMC()_RESET_CTL[DDR3PWARM, DDR3PSOFT].
	Parameters:
	    RANKS#: Specifies that this parameter only applies to DIMMs
	        with the supplied number of ranks. Support ranks is 1, 2,
	        or 4. Optional.
	    DIMMS#: Specifies that this parameter only applies when the
	        DIMMs per memory controller matches. Support number of
	        DIMMs is 1 or 2. Optional.
	    RANK#: Parameter can be different for each rank of a DIMM. This
	        specifies which rank the value is for. Rank must be
	        0-3. Optional.
	    LMC#: Parameter can be different for memory controller. This
	        specifies which LMC the value is for. LMC must be
	        0-3. Optional.
	    N#: Parameter can be different for each node. This specifies
	        which node the value is for. Node must be 0-3. Optional. */
	//DDR-CONFIG-MODE1-RTT-WR.RANKS%d.DIMMS%d.RANK%d.LMC%d.N%d = "0";
	DDR-CONFIG-MODE1-RTT-WR.RANKS2.DIMMS2.RANK3.LMC3.N0 = "0x2";
	DDR-CONFIG-MODE1-RTT-WR.RANKS2.DIMMS2.RANK2.LMC3.N0 = "0x2";
	DDR-CONFIG-MODE1-RTT-WR.RANKS2.DIMMS2.RANK1.LMC3.N0 = "0x2";
	DDR-CONFIG-MODE1-RTT-WR.RANKS2.DIMMS2.RANK0.LMC3.N0 = "0x2";
	DDR-CONFIG-MODE1-RTT-WR.RANKS1.DIMMS2.RANK2.LMC3.N0 = "0x3";
	DDR-CONFIG-MODE1-RTT-WR.RANKS1.DIMMS2.RANK0.LMC3.N0 = "0x3";
	DDR-CONFIG-MODE1-RTT-WR.RANKS4.DIMMS1.RANK3.LMC3.N0 = "0x1";
	DDR-CONFIG-MODE1-RTT-WR.RANKS4.DIMMS1.RANK2.LMC3.N0 = "0x1";
	DDR-CONFIG-MODE1-RTT-WR.RANKS4.DIMMS1.RANK1.LMC3.N0 = "0x1";
	DDR-CONFIG-MODE1-RTT-WR.RANKS4.DIMMS1.RANK0.LMC3.N0 = "0x1";
	DDR-CONFIG-MODE1-RTT-WR.RANKS2.DIMMS1.RANK1.LMC3.N0 = "0x2";
	DDR-CONFIG-MODE1-RTT-WR.RANKS2.DIMMS1.RANK0.LMC3.N0 = "0x2";
	DDR-CONFIG-MODE1-RTT-WR.RANKS2.DIMMS2.RANK3.LMC2.N0 = "0x2";
	DDR-CONFIG-MODE1-RTT-WR.RANKS2.DIMMS2.RANK2.LMC2.N0 = "0x2";
	DDR-CONFIG-MODE1-RTT-WR.RANKS2.DIMMS2.RANK1.LMC2.N0 = "0x2";
	DDR-CONFIG-MODE1-RTT-WR.RANKS2.DIMMS2.RANK0.LMC2.N0 = "0x2";
	DDR-CONFIG-MODE1-RTT-WR.RANKS1.DIMMS2.RANK2.LMC2.N0 = "0x3";
	DDR-CONFIG-MODE1-RTT-WR.RANKS1.DIMMS2.RANK0.LMC2.N0 = "0x3";
	DDR-CONFIG-MODE1-RTT-WR.RANKS4.DIMMS1.RANK3.LMC2.N0 = "0x1";
	DDR-CONFIG-MODE1-RTT-WR.RANKS4.DIMMS1.RANK2.LMC2.N0 = "0x1";
	DDR-CONFIG-MODE1-RTT-WR.RANKS4.DIMMS1.RANK1.LMC2.N0 = "0x1";
	DDR-CONFIG-MODE1-RTT-WR.RANKS4.DIMMS1.RANK0.LMC2.N0 = "0x1";
	DDR-CONFIG-MODE1-RTT-WR.RANKS2.DIMMS1.RANK1.LMC2.N0 = "0x2";
	DDR-CONFIG-MODE1-RTT-WR.RANKS2.DIMMS1.RANK0.LMC2.N0 = "0x2";
	DDR-CONFIG-MODE1-RTT-WR.RANKS2.DIMMS2.RANK3.LMC1.N0 = "0x2";
	DDR-CONFIG-MODE1-RTT-WR.RANKS2.DIMMS2.RANK2.LMC1.N0 = "0x2";
	DDR-CONFIG-MODE1-RTT-WR.RANKS2.DIMMS2.RANK1.LMC1.N0 = "0x2";
	DDR-CONFIG-MODE1-RTT-WR.RANKS2.DIMMS2.RANK0.LMC1.N0 = "0x2";
	DDR-CONFIG-MODE1-RTT-WR.RANKS1.DIMMS2.RANK2.LMC1.N0 = "0x3";
	DDR-CONFIG-MODE1-RTT-WR.RANKS1.DIMMS2.RANK0.LMC1.N0 = "0x3";
	DDR-CONFIG-MODE1-RTT-WR.RANKS4.DIMMS1.RANK3.LMC1.N0 = "0x1";
	DDR-CONFIG-MODE1-RTT-WR.RANKS4.DIMMS1.RANK2.LMC1.N0 = "0x1";
	DDR-CONFIG-MODE1-RTT-WR.RANKS4.DIMMS1.RANK1.LMC1.N0 = "0x1";
	DDR-CONFIG-MODE1-RTT-WR.RANKS4.DIMMS1.RANK0.LMC1.N0 = "0x1";
	DDR-CONFIG-MODE1-RTT-WR.RANKS2.DIMMS1.RANK1.LMC1.N0 = "0x2";
	DDR-CONFIG-MODE1-RTT-WR.RANKS2.DIMMS1.RANK0.LMC1.N0 = "0x2";
	DDR-CONFIG-MODE1-RTT-WR.RANKS2.DIMMS2.RANK3.LMC0.N0 = "0x2";
	DDR-CONFIG-MODE1-RTT-WR.RANKS2.DIMMS2.RANK2.LMC0.N0 = "0x2";
	DDR-CONFIG-MODE1-RTT-WR.RANKS2.DIMMS2.RANK1.LMC0.N0 = "0x2";
	DDR-CONFIG-MODE1-RTT-WR.RANKS2.DIMMS2.RANK0.LMC0.N0 = "0x2";
	DDR-CONFIG-MODE1-RTT-WR.RANKS1.DIMMS2.RANK2.LMC0.N0 = "0x3";
	DDR-CONFIG-MODE1-RTT-WR.RANKS1.DIMMS2.RANK0.LMC0.N0 = "0x3";
	DDR-CONFIG-MODE1-RTT-WR.RANKS4.DIMMS1.RANK3.LMC0.N0 = "0x1";
	DDR-CONFIG-MODE1-RTT-WR.RANKS4.DIMMS1.RANK2.LMC0.N0 = "0x1";
	DDR-CONFIG-MODE1-RTT-WR.RANKS4.DIMMS1.RANK1.LMC0.N0 = "0x1";
	DDR-CONFIG-MODE1-RTT-WR.RANKS4.DIMMS1.RANK0.LMC0.N0 = "0x1";
	DDR-CONFIG-MODE1-RTT-WR.RANKS2.DIMMS1.RANK1.LMC0.N0 = "0x2";
	DDR-CONFIG-MODE1-RTT-WR.RANKS2.DIMMS1.RANK0.LMC0.N0 = "0x2";

	/* Output driver impedance control per rank. LMC writes this value
	to MR1[D.I.C.] in the rank (i.e. DIMM0_CS0) DDR3 parts when
	selected during power-up/init, write-leveling, and, if
	LMC()_CONFIG[SREF_WITH_DLL] is set, self-refresh entry and exit
	instruction sequences. See LMC()_SEQ_CTL[SEQ_SEL,INIT_START] and
	LMC()_CONFIG[RANKMASK] and LMC()_RESET_CTL[DDR3PWARM,DDR3PSOFT].
	Parameters:
	    RANKS#: Specifies that this parameter only applies to DIMMs
	        with the supplied number of ranks. Support ranks is 1, 2,
	        or 4. Optional.
	    DIMMS#: Specifies that this parameter only applies when the
	        DIMMs per memory controller matches. Support number of
	        DIMMs is 1 or 2. Optional.
	    RANK#: Parameter can be different for each rank of a DIMM. This
	        specifies which rank the value is for. Rank must be
	        0-3. Optional.
	    LMC#: Parameter can be different for memory controller. This
	        specifies which LMC the value is for. LMC must be
	        0-3. Optional.
	    N#: Parameter can be different for each node. This specifies
	        which node the value is for. Node must be 0-3. Optional. */
	//DDR-CONFIG-MODE1-DIC.RANKS%d.DIMMS%d.RANK%d.LMC%d.N%d = "0";
	DDR-CONFIG-MODE1-DIC.RANKS4.DIMMS1.RANK3.LMC3.N0 = "0x1";
	DDR-CONFIG-MODE1-DIC.RANKS4.DIMMS1.RANK2.LMC3.N0 = "0x1";
	DDR-CONFIG-MODE1-DIC.RANKS4.DIMMS1.RANK1.LMC3.N0 = "0x1";
	DDR-CONFIG-MODE1-DIC.RANKS4.DIMMS1.RANK0.LMC3.N0 = "0x1";
	DDR-CONFIG-MODE1-DIC.RANKS4.DIMMS1.RANK3.LMC2.N0 = "0x1";
	DDR-CONFIG-MODE1-DIC.RANKS4.DIMMS1.RANK2.LMC2.N0 = "0x1";
	DDR-CONFIG-MODE1-DIC.RANKS4.DIMMS1.RANK1.LMC2.N0 = "0x1";
	DDR-CONFIG-MODE1-DIC.RANKS4.DIMMS1.RANK0.LMC2.N0 = "0x1";
	DDR-CONFIG-MODE1-DIC.RANKS4.DIMMS1.RANK3.LMC1.N0 = "0x1";
	DDR-CONFIG-MODE1-DIC.RANKS4.DIMMS1.RANK2.LMC1.N0 = "0x1";
	DDR-CONFIG-MODE1-DIC.RANKS4.DIMMS1.RANK1.LMC1.N0 = "0x1";
	DDR-CONFIG-MODE1-DIC.RANKS4.DIMMS1.RANK0.LMC1.N0 = "0x1";
	DDR-CONFIG-MODE1-DIC.RANKS4.DIMMS1.RANK3.LMC0.N0 = "0x1";
	DDR-CONFIG-MODE1-DIC.RANKS4.DIMMS1.RANK2.LMC0.N0 = "0x1";
	DDR-CONFIG-MODE1-DIC.RANKS4.DIMMS1.RANK1.LMC0.N0 = "0x1";
	DDR-CONFIG-MODE1-DIC.RANKS4.DIMMS1.RANK0.LMC0.N0 = "0x1";

	/* RTT_NOM per rank. LMC writes this value to MR1[RTT_NOM] in the
	rank (i.e. DIMM0_CS0) DDR3 parts when selected during
	power-up/init, write-leveling, and, if LMC()_CONFIG[SREF_WITH_DLL]
	is set, self-refresh entry and exit instruction sequences. See
	LMC()_SEQ_CTL[SEQ_SEL,INIT_START] and LMC()_CONFIG[RANKMASK] and
	LMC()_RESET_CTL[DDR3PWARM, DDR3PSOFT]. Per JEDEC DDR3
	specifications, if RTT_NOM is used during write operations, only
	values MR1[RTT_NOM] = 1 (RZQ/4), 2 (RZQ/2), or 3 (RZQ/6) are
	allowed. Otherwise, values MR1[RTT_NOM] = 4 (RZQ/12) and 5 (RZQ/8)
	are also allowed.
	Parameters:
	    RANKS#: Specifies that this parameter only applies to DIMMs
	        with the supplied number of ranks. Support ranks is 1, 2,
	        or 4. Optional.
	    DIMMS#: Specifies that this parameter only applies when the
	        DIMMs per memory controller matches. Support number of
	        DIMMs is 1 or 2. Optional.
	    RANK#: Parameter can be different for each rank of a DIMM. This
	        specifies which rank the value is for. Rank must be
	        0-3. Optional.
	    LMC#: Parameter can be different for memory controller. This
	        specifies which LMC the value is for. LMC must be
	        0-3. Optional.
	    N#: Parameter can be different for each node. This specifies
	        which node the value is for. Node must be 0-3. Optional. */
	//DDR-CONFIG-MODE1-RTT-NOM.RANKS%d.DIMMS%d.RANK%d.LMC%d.N%d = "0";
	DDR-CONFIG-MODE1-RTT-NOM.RANKS2.DIMMS2.RANK3.LMC3.N0 = "0x4";
	DDR-CONFIG-MODE1-RTT-NOM.RANKS2.DIMMS2.RANK2.LMC3.N0 = "0x4";
	DDR-CONFIG-MODE1-RTT-NOM.RANKS2.DIMMS2.RANK1.LMC3.N0 = "0x4";
	DDR-CONFIG-MODE1-RTT-NOM.RANKS2.DIMMS2.RANK0.LMC3.N0 = "0x4";
	DDR-CONFIG-MODE1-RTT-NOM.RANKS4.DIMMS1.RANK2.LMC3.N0 = "0x4";
	DDR-CONFIG-MODE1-RTT-NOM.RANKS4.DIMMS1.RANK0.LMC3.N0 = "0x4";
	DDR-CONFIG-MODE1-RTT-NOM.RANKS2.DIMMS2.RANK3.LMC2.N0 = "0x4";
	DDR-CONFIG-MODE1-RTT-NOM.RANKS2.DIMMS2.RANK2.LMC2.N0 = "0x4";
	DDR-CONFIG-MODE1-RTT-NOM.RANKS2.DIMMS2.RANK1.LMC2.N0 = "0x4";
	DDR-CONFIG-MODE1-RTT-NOM.RANKS2.DIMMS2.RANK0.LMC2.N0 = "0x4";
	DDR-CONFIG-MODE1-RTT-NOM.RANKS4.DIMMS1.RANK2.LMC2.N0 = "0x4";
	DDR-CONFIG-MODE1-RTT-NOM.RANKS4.DIMMS1.RANK0.LMC2.N0 = "0x4";
	DDR-CONFIG-MODE1-RTT-NOM.RANKS2.DIMMS2.RANK3.LMC1.N0 = "0x4";
	DDR-CONFIG-MODE1-RTT-NOM.RANKS2.DIMMS2.RANK2.LMC1.N0 = "0x4";
	DDR-CONFIG-MODE1-RTT-NOM.RANKS2.DIMMS2.RANK1.LMC1.N0 = "0x4";
	DDR-CONFIG-MODE1-RTT-NOM.RANKS2.DIMMS2.RANK0.LMC1.N0 = "0x4";
	DDR-CONFIG-MODE1-RTT-NOM.RANKS4.DIMMS1.RANK2.LMC1.N0 = "0x4";
	DDR-CONFIG-MODE1-RTT-NOM.RANKS4.DIMMS1.RANK0.LMC1.N0 = "0x4";
	DDR-CONFIG-MODE1-RTT-NOM.RANKS2.DIMMS2.RANK3.LMC0.N0 = "0x4";
	DDR-CONFIG-MODE1-RTT-NOM.RANKS2.DIMMS2.RANK2.LMC0.N0 = "0x4";
	DDR-CONFIG-MODE1-RTT-NOM.RANKS2.DIMMS2.RANK1.LMC0.N0 = "0x4";
	DDR-CONFIG-MODE1-RTT-NOM.RANKS2.DIMMS2.RANK0.LMC0.N0 = "0x4";
	DDR-CONFIG-MODE1-RTT-NOM.RANKS4.DIMMS1.RANK2.LMC0.N0 = "0x4";
	DDR-CONFIG-MODE1-RTT-NOM.RANKS4.DIMMS1.RANK0.LMC0.N0 = "0x4";

	/* Host Interface DQ/DQS Output Driver Impedance control for DIMM0's
	Data Buffer. This is the default value used during Host Interface
	Write Leveling in LRDIMM environment, i.e.,
	LMC()_CONFIG[LRDIMM_ENA] = 1, LMC()_SEQ_CTL[SEQ_SEL] = 0x6.
	    0x0 = RZQ/6 (40 ohm).
	    0x1 = RZQ/7 (34 ohm).
	    0x2 = RZQ/5 (48 ohm).
	    0x3-0x7 = Reserved.
	Parameters:
	    RANKS#: Specifies that this parameter only applies to DIMMs
	        with the supplied number of ranks. Support ranks is 1, 2,
	        or 4. Optional.
	    DIMMS#: Specifies that this parameter only applies when the
	        DIMMs per memory controller matches. Support number of
	        DIMMs is 1 or 2. Optional.
	    LMC#: Parameter can be different for memory controller. This
	        specifies which LMC the value is for. LMC must be
	        0-3. Optional.
	    N#: Parameter can be different for each node. This specifies
	        which node the value is for. Node must be 0-3. Optional. */
	//DDR-CONFIG-MODE1-DB-OUTPUT-IMPEDANCE.RANKS%d.DIMMS%d.LMC%d.N%d = "0";

	/* RTT park value per rank.
	Parameters:
	    RANKS#: Specifies that this parameter only applies to DIMMs
	        with the supplied number of ranks. Support ranks is 1, 2,
	        or 4. Optional.
	    DIMMS#: Specifies that this parameter only applies when the
	        DIMMs per memory controller matches. Support number of
	        DIMMs is 1 or 2. Optional.
	    RANK#: Parameter can be different for each rank of a DIMM. This
	        specifies which rank the value is for. Rank must be
	        0-3. Optional.
	    LMC#: Parameter can be different for memory controller. This
	        specifies which LMC the value is for. LMC must be
	        0-3. Optional.
	    N#: Parameter can be different for each node. This specifies
	        which node the value is for. Node must be 0-3. Optional. */
	//DDR-CONFIG-MODE2-RTT-PARK.RANKS%d.DIMMS%d.RANK%d.LMC%d.N%d = "0";
	DDR-CONFIG-MODE2-RTT-PARK.RANKS2.DIMMS2.RANK3.LMC3.N0 = "0x3";
	DDR-CONFIG-MODE2-RTT-PARK.RANKS2.DIMMS2.RANK2.LMC3.N0 = "0x3";
	DDR-CONFIG-MODE2-RTT-PARK.RANKS2.DIMMS2.RANK1.LMC3.N0 = "0x3";
	DDR-CONFIG-MODE2-RTT-PARK.RANKS2.DIMMS2.RANK0.LMC3.N0 = "0x3";
	DDR-CONFIG-MODE2-RTT-PARK.RANKS1.DIMMS2.RANK2.LMC3.N0 = "0x7";
	DDR-CONFIG-MODE2-RTT-PARK.RANKS1.DIMMS2.RANK0.LMC3.N0 = "0x7";
	DDR-CONFIG-MODE2-RTT-PARK.RANKS4.DIMMS1.RANK1.LMC3.N0 = "0x6";
	DDR-CONFIG-MODE2-RTT-PARK.RANKS4.DIMMS1.RANK0.LMC3.N0 = "0x6";
	DDR-CONFIG-MODE2-RTT-PARK.RANKS2.DIMMS1.RANK1.LMC3.N0 = "0x2";
	DDR-CONFIG-MODE2-RTT-PARK.RANKS2.DIMMS1.RANK0.LMC3.N0 = "0x2";
	DDR-CONFIG-MODE2-RTT-PARK.RANKS1.DIMMS1.RANK0.LMC3.N0 = "0x1";
	DDR-CONFIG-MODE2-RTT-PARK.RANKS2.DIMMS2.RANK3.LMC2.N0 = "0x3";
	DDR-CONFIG-MODE2-RTT-PARK.RANKS2.DIMMS2.RANK2.LMC2.N0 = "0x3";
	DDR-CONFIG-MODE2-RTT-PARK.RANKS2.DIMMS2.RANK1.LMC2.N0 = "0x3";
	DDR-CONFIG-MODE2-RTT-PARK.RANKS2.DIMMS2.RANK0.LMC2.N0 = "0x3";
	DDR-CONFIG-MODE2-RTT-PARK.RANKS1.DIMMS2.RANK2.LMC2.N0 = "0x7";
	DDR-CONFIG-MODE2-RTT-PARK.RANKS1.DIMMS2.RANK0.LMC2.N0 = "0x7";
	DDR-CONFIG-MODE2-RTT-PARK.RANKS4.DIMMS1.RANK1.LMC2.N0 = "0x6";
	DDR-CONFIG-MODE2-RTT-PARK.RANKS4.DIMMS1.RANK0.LMC2.N0 = "0x6";
	DDR-CONFIG-MODE2-RTT-PARK.RANKS2.DIMMS1.RANK1.LMC2.N0 = "0x2";
	DDR-CONFIG-MODE2-RTT-PARK.RANKS2.DIMMS1.RANK0.LMC2.N0 = "0x2";
	DDR-CONFIG-MODE2-RTT-PARK.RANKS1.DIMMS1.RANK0.LMC2.N0 = "0x1";
	DDR-CONFIG-MODE2-RTT-PARK.RANKS2.DIMMS2.RANK3.LMC1.N0 = "0x3";
	DDR-CONFIG-MODE2-RTT-PARK.RANKS2.DIMMS2.RANK2.LMC1.N0 = "0x3";
	DDR-CONFIG-MODE2-RTT-PARK.RANKS2.DIMMS2.RANK1.LMC1.N0 = "0x3";
	DDR-CONFIG-MODE2-RTT-PARK.RANKS2.DIMMS2.RANK0.LMC1.N0 = "0x3";
	DDR-CONFIG-MODE2-RTT-PARK.RANKS1.DIMMS2.RANK2.LMC1.N0 = "0x7";
	DDR-CONFIG-MODE2-RTT-PARK.RANKS1.DIMMS2.RANK0.LMC1.N0 = "0x7";
	DDR-CONFIG-MODE2-RTT-PARK.RANKS4.DIMMS1.RANK1.LMC1.N0 = "0x6";
	DDR-CONFIG-MODE2-RTT-PARK.RANKS4.DIMMS1.RANK0.LMC1.N0 = "0x6";
	DDR-CONFIG-MODE2-RTT-PARK.RANKS2.DIMMS1.RANK1.LMC1.N0 = "0x2";
	DDR-CONFIG-MODE2-RTT-PARK.RANKS2.DIMMS1.RANK0.LMC1.N0 = "0x2";
	DDR-CONFIG-MODE2-RTT-PARK.RANKS1.DIMMS1.RANK0.LMC1.N0 = "0x1";
	DDR-CONFIG-MODE2-RTT-PARK.RANKS2.DIMMS2.RANK3.LMC0.N0 = "0x3";
	DDR-CONFIG-MODE2-RTT-PARK.RANKS2.DIMMS2.RANK2.LMC0.N0 = "0x3";
	DDR-CONFIG-MODE2-RTT-PARK.RANKS2.DIMMS2.RANK1.LMC0.N0 = "0x3";
	DDR-CONFIG-MODE2-RTT-PARK.RANKS2.DIMMS2.RANK0.LMC0.N0 = "0x3";
	DDR-CONFIG-MODE2-RTT-PARK.RANKS1.DIMMS2.RANK2.LMC0.N0 = "0x7";
	DDR-CONFIG-MODE2-RTT-PARK.RANKS1.DIMMS2.RANK0.LMC0.N0 = "0x7";
	DDR-CONFIG-MODE2-RTT-PARK.RANKS4.DIMMS1.RANK1.LMC0.N0 = "0x6";
	DDR-CONFIG-MODE2-RTT-PARK.RANKS4.DIMMS1.RANK0.LMC0.N0 = "0x6";
	DDR-CONFIG-MODE2-RTT-PARK.RANKS2.DIMMS1.RANK1.LMC0.N0 = "0x2";
	DDR-CONFIG-MODE2-RTT-PARK.RANKS2.DIMMS1.RANK0.LMC0.N0 = "0x2";
	DDR-CONFIG-MODE2-RTT-PARK.RANKS1.DIMMS1.RANK0.LMC0.N0 = "0x1";

	/* VREF value per rank.
	Parameters:
	    RANKS#: Specifies that this parameter only applies to DIMMs
	        with the supplied number of ranks. Support ranks is 1, 2,
	        or 4. Optional.
	    DIMMS#: Specifies that this parameter only applies when the
	        DIMMs per memory controller matches. Support number of
	        DIMMs is 1 or 2. Optional.
	    RANK#: Parameter can be different for each rank of a DIMM. This
	        specifies which rank the value is for. Rank must be
	        0-3. Optional.
	    LMC#: Parameter can be different for memory controller. This
	        specifies which LMC the value is for. LMC must be
	        0-3. Optional.
	    N#: Parameter can be different for each node. This specifies
	        which node the value is for. Node must be 0-3. Optional. */
	//DDR-CONFIG-MODE2-VREF-VALUE.RANKS%d.DIMMS%d.RANK%d.LMC%d.N%d = "0";
	DDR-CONFIG-MODE2-VREF-VALUE.RANKS2.DIMMS2.RANK3.LMC3.N0 = "0x19";
	DDR-CONFIG-MODE2-VREF-VALUE.RANKS2.DIMMS2.RANK2.LMC3.N0 = "0x19";
	DDR-CONFIG-MODE2-VREF-VALUE.RANKS2.DIMMS2.RANK1.LMC3.N0 = "0x19";
	DDR-CONFIG-MODE2-VREF-VALUE.RANKS2.DIMMS2.RANK0.LMC3.N0 = "0x19";
	DDR-CONFIG-MODE2-VREF-VALUE.RANKS1.DIMMS2.RANK2.LMC3.N0 = "0x1f";
	DDR-CONFIG-MODE2-VREF-VALUE.RANKS1.DIMMS2.RANK0.LMC3.N0 = "0x1f";
	DDR-CONFIG-MODE2-VREF-VALUE.RANKS4.DIMMS1.RANK1.LMC3.N0 = "0x1f";
	DDR-CONFIG-MODE2-VREF-VALUE.RANKS4.DIMMS1.RANK0.LMC3.N0 = "0x1f";
	DDR-CONFIG-MODE2-VREF-VALUE.RANKS2.DIMMS1.RANK1.LMC3.N0 = "0x19";
	DDR-CONFIG-MODE2-VREF-VALUE.RANKS2.DIMMS1.RANK0.LMC3.N0 = "0x19";
	DDR-CONFIG-MODE2-VREF-VALUE.RANKS1.DIMMS1.RANK0.LMC3.N0 = "0x22";
	DDR-CONFIG-MODE2-VREF-VALUE.RANKS2.DIMMS2.RANK3.LMC2.N0 = "0x19";
	DDR-CONFIG-MODE2-VREF-VALUE.RANKS2.DIMMS2.RANK2.LMC2.N0 = "0x19";
	DDR-CONFIG-MODE2-VREF-VALUE.RANKS2.DIMMS2.RANK1.LMC2.N0 = "0x19";
	DDR-CONFIG-MODE2-VREF-VALUE.RANKS2.DIMMS2.RANK0.LMC2.N0 = "0x19";
	DDR-CONFIG-MODE2-VREF-VALUE.RANKS1.DIMMS2.RANK2.LMC2.N0 = "0x1f";
	DDR-CONFIG-MODE2-VREF-VALUE.RANKS1.DIMMS2.RANK0.LMC2.N0 = "0x1f";
	DDR-CONFIG-MODE2-VREF-VALUE.RANKS4.DIMMS1.RANK1.LMC2.N0 = "0x1f";
	DDR-CONFIG-MODE2-VREF-VALUE.RANKS4.DIMMS1.RANK0.LMC2.N0 = "0x1f";
	DDR-CONFIG-MODE2-VREF-VALUE.RANKS2.DIMMS1.RANK1.LMC2.N0 = "0x19";
	DDR-CONFIG-MODE2-VREF-VALUE.RANKS2.DIMMS1.RANK0.LMC2.N0 = "0x19";
	DDR-CONFIG-MODE2-VREF-VALUE.RANKS1.DIMMS1.RANK0.LMC2.N0 = "0x22";
	DDR-CONFIG-MODE2-VREF-VALUE.RANKS2.DIMMS2.RANK3.LMC1.N0 = "0x19";
	DDR-CONFIG-MODE2-VREF-VALUE.RANKS2.DIMMS2.RANK2.LMC1.N0 = "0x19";
	DDR-CONFIG-MODE2-VREF-VALUE.RANKS2.DIMMS2.RANK1.LMC1.N0 = "0x19";
	DDR-CONFIG-MODE2-VREF-VALUE.RANKS2.DIMMS2.RANK0.LMC1.N0 = "0x19";
	DDR-CONFIG-MODE2-VREF-VALUE.RANKS1.DIMMS2.RANK2.LMC1.N0 = "0x1f";
	DDR-CONFIG-MODE2-VREF-VALUE.RANKS1.DIMMS2.RANK0.LMC1.N0 = "0x1f";
	DDR-CONFIG-MODE2-VREF-VALUE.RANKS4.DIMMS1.RANK1.LMC1.N0 = "0x1f";
	DDR-CONFIG-MODE2-VREF-VALUE.RANKS4.DIMMS1.RANK0.LMC1.N0 = "0x1f";
	DDR-CONFIG-MODE2-VREF-VALUE.RANKS2.DIMMS1.RANK1.LMC1.N0 = "0x19";
	DDR-CONFIG-MODE2-VREF-VALUE.RANKS2.DIMMS1.RANK0.LMC1.N0 = "0x19";
	DDR-CONFIG-MODE2-VREF-VALUE.RANKS1.DIMMS1.RANK0.LMC1.N0 = "0x22";
	DDR-CONFIG-MODE2-VREF-VALUE.RANKS2.DIMMS2.RANK3.LMC0.N0 = "0x19";
	DDR-CONFIG-MODE2-VREF-VALUE.RANKS2.DIMMS2.RANK2.LMC0.N0 = "0x19";
	DDR-CONFIG-MODE2-VREF-VALUE.RANKS2.DIMMS2.RANK1.LMC0.N0 = "0x19";
	DDR-CONFIG-MODE2-VREF-VALUE.RANKS2.DIMMS2.RANK0.LMC0.N0 = "0x19";
	DDR-CONFIG-MODE2-VREF-VALUE.RANKS1.DIMMS2.RANK2.LMC0.N0 = "0x1f";
	DDR-CONFIG-MODE2-VREF-VALUE.RANKS1.DIMMS2.RANK0.LMC0.N0 = "0x1f";
	DDR-CONFIG-MODE2-VREF-VALUE.RANKS4.DIMMS1.RANK1.LMC0.N0 = "0x1f";
	DDR-CONFIG-MODE2-VREF-VALUE.RANKS4.DIMMS1.RANK0.LMC0.N0 = "0x1f";
	DDR-CONFIG-MODE2-VREF-VALUE.RANKS2.DIMMS1.RANK1.LMC0.N0 = "0x19";
	DDR-CONFIG-MODE2-VREF-VALUE.RANKS2.DIMMS1.RANK0.LMC0.N0 = "0x19";
	DDR-CONFIG-MODE2-VREF-VALUE.RANKS1.DIMMS1.RANK0.LMC0.N0 = "0x22";

	/* VREF range per rank.
	Parameters:
	    RANKS#: Specifies that this parameter only applies to DIMMs
	        with the supplied number of ranks. Support ranks is 1, 2,
	        or 4. Optional.
	    DIMMS#: Specifies that this parameter only applies when the
	        DIMMs per memory controller matches. Support number of
	        DIMMs is 1 or 2. Optional.
	    RANK#: Parameter can be different for each rank of a DIMM. This
	        specifies which rank the value is for. Rank must be
	        0-3. Optional.
	    LMC#: Parameter can be different for memory controller. This
	        specifies which LMC the value is for. LMC must be
	        0-3. Optional.
	    N#: Parameter can be different for each node. This specifies
	        which node the value is for. Node must be 0-3. Optional. */
	//DDR-CONFIG-MODE2-VREF-RANGE.RANKS%d.DIMMS%d.RANK%d.LMC%d.N%d = "0";

	/* Vref training mode enable, used for all ranks.
	Parameters:
	    RANKS#: Specifies that this parameter only applies to DIMMs
	        with the supplied number of ranks. Support ranks is 1, 2,
	        or 4. Optional.
	    DIMMS#: Specifies that this parameter only applies when the
	        DIMMs per memory controller matches. Support number of
	        DIMMs is 1 or 2. Optional.
	    LMC#: Parameter can be different for memory controller. This
	        specifies which LMC the value is for. LMC must be
	        0-3. Optional.
	    N#: Parameter can be different for each node. This specifies
	        which node the value is for. Node must be 0-3. Optional. */
	//DDR-CONFIG-MODE2-VREFDQ-TRAIN-EN.RANKS%d.DIMMS%d.LMC%d.N%d = "0";

	/* RODT NCTL impedance control bits. This field controls ODT values
	during a memory read.
	    0x0 = No ODT.
	    0x1 = 20 ohm.
	    0x2 = 30 ohm.
	    0x3 = 40 ohm.
	    0x4 = 60 ohm.
	    0x5 = 120 ohm.
	    _ else = Reserved.
	In DDR4 mode:
	    0x0 = No ODT.
	    0x1 = 40 ohm.
	    0x2 = 60 ohm.
	    0x3 = 80 ohm.
	    0x4 = 120 ohm.
	    0x5 = 240 ohm.
	    0x6 = 34 ohm.
	    0x7 = 48 ohm.
	    _ else = Reserved.
	Parameters:
	    RANKS#: Specifies that this parameter only applies to DIMMs
	        with the supplied number of ranks. Support ranks is 1, 2,
	        or 4. Optional.
	    DIMMS#: Specifies that this parameter only applies when the
	        DIMMs per memory controller matches. Support number of
	        DIMMs is 1 or 2. Optional.
	    LMC#: Parameter can be different for memory controller. This
	        specifies which LMC the value is for. LMC must be
	        0-3. Optional.
	    N#: Parameter can be different for each node. This specifies
	        which node the value is for. Node must be 0-3. Optional. */
	//DDR-CONFIG-RODT-CTL.RANKS%d.DIMMS%d.LMC%d.N%d = "0";
	DDR-CONFIG-RODT-CTL.RANKS2.DIMMS2.LMC3.N0 = "0x7";
	DDR-CONFIG-RODT-CTL.RANKS1.DIMMS2.LMC3.N0 = "0x7";
	DDR-CONFIG-RODT-CTL.RANKS4.DIMMS1.LMC3.N0 = "0x7";
	DDR-CONFIG-RODT-CTL.RANKS2.DIMMS1.LMC3.N0 = "0x3";
	DDR-CONFIG-RODT-CTL.RANKS1.DIMMS1.LMC3.N0 = "0x7";
	DDR-CONFIG-RODT-CTL.RANKS2.DIMMS2.LMC2.N0 = "0x7";
	DDR-CONFIG-RODT-CTL.RANKS1.DIMMS2.LMC2.N0 = "0x7";
	DDR-CONFIG-RODT-CTL.RANKS4.DIMMS1.LMC2.N0 = "0x7";
	DDR-CONFIG-RODT-CTL.RANKS2.DIMMS1.LMC2.N0 = "0x3";
	DDR-CONFIG-RODT-CTL.RANKS1.DIMMS1.LMC2.N0 = "0x7";
	DDR-CONFIG-RODT-CTL.RANKS2.DIMMS2.LMC1.N0 = "0x7";
	DDR-CONFIG-RODT-CTL.RANKS1.DIMMS2.LMC1.N0 = "0x7";
	DDR-CONFIG-RODT-CTL.RANKS4.DIMMS1.LMC1.N0 = "0x7";
	DDR-CONFIG-RODT-CTL.RANKS2.DIMMS1.LMC1.N0 = "0x3";
	DDR-CONFIG-RODT-CTL.RANKS1.DIMMS1.LMC1.N0 = "0x7";
	DDR-CONFIG-RODT-CTL.RANKS2.DIMMS2.LMC0.N0 = "0x7";
	DDR-CONFIG-RODT-CTL.RANKS1.DIMMS2.LMC0.N0 = "0x7";
	DDR-CONFIG-RODT-CTL.RANKS4.DIMMS1.LMC0.N0 = "0x7";
	DDR-CONFIG-RODT-CTL.RANKS2.DIMMS1.LMC0.N0 = "0x3";
	DDR-CONFIG-RODT-CTL.RANKS1.DIMMS1.LMC0.N0 = "0x7";

	/* LMC Read OnDieTermination Mask Register
	System designers may desire to terminate DQ/DQS lines for higher
	frequency DDR operations, especially on a multirank system. DDR3
	DQ/DQS I/Os have built-in termination resistors that can be turned
	on or off by the controller, after meeting TAOND and TAOF timing
	requirements.
	Each rank has its own ODT pin that fans out to all the memory
	parts in that DIMM. System designers may prefer different
	combinations of ODT ONs for read operations into different ranks.
	CNXXXX supports full programmability by way of the mask register
	below. Each rank position has its own 4-bit programmable field.
	When the controller does a read to that rank, it sets the 4 ODT
	pins to the MASK pins below. For example, when doing a read from
	Rank0, a system designer may desire to terminate the lines with
	the resistor on DIMM0/Rank1. The mask RODT_D0_R0 would then be {0010}.
	CNXXXX drives the appropriate mask values on the ODT pins by
	default. If this feature is not required, write 0x0 in this
	register. Note that, as per the JEDEC DDR3 specifications, the ODT
	pin for the rank that is being read should always be 0x0. When a
	given RANK is selected, the RODT mask for that rank is used.
	Parameters:
	    RANKS#: Specifies that this parameter only applies to DIMMs
	        with the supplied number of ranks. Support ranks is 1, 2,
	        or 4. Optional.
	    DIMMS#: Specifies that this parameter only applies when the
	        DIMMs per memory controller matches. Support number of
	        DIMMs is 1 or 2. Optional.
	    LMC#: Parameter can be different for memory controller. This
	        specifies which LMC the value is for. LMC must be
	        0-3. Optional.
	    N#: Parameter can be different for each node. This specifies
	        which node the value is for. Node must be 0-3. Optional. */
	//DDR-CONFIG-RODT-MASK.RANKS%d.DIMMS%d.LMC%d.N%d = "0";
	DDR-CONFIG-RODT-MASK.RANKS2.DIMMS2.LMC3.N0 = "0x4080102";
	DDR-CONFIG-RODT-MASK.RANKS4.DIMMS1.LMC3.N0 = "0x1010202";
	DDR-CONFIG-RODT-MASK.RANKS2.DIMMS2.LMC2.N0 = "0x4080102";
	DDR-CONFIG-RODT-MASK.RANKS4.DIMMS1.LMC2.N0 = "0x1010202";
	DDR-CONFIG-RODT-MASK.RANKS2.DIMMS2.LMC1.N0 = "0x4080102";
	DDR-CONFIG-RODT-MASK.RANKS4.DIMMS1.LMC1.N0 = "0x1010202";
	DDR-CONFIG-RODT-MASK.RANKS2.DIMMS2.LMC0.N0 = "0x4080102";
	DDR-CONFIG-RODT-MASK.RANKS4.DIMMS1.LMC0.N0 = "0x1010202";

	/* 1=120ohms, 2=60ohms, 3=40ohms, 4=30ohms, 5=20ohms
	Parameters:
	    LMC#: Parameter can be different for memory controller. This
	        specifies which LMC the value is for. LMC must be
	        0-3. Optional.
	    N#: Parameter can be different for each node. This specifies
	        which node the value is for. Node must be 0-3. Optional. */
	//DDR-CONFIG-CUSTOM-MIN-RTT-NOM-IDX.LMC%d.N%d = "1";
	DDR-CONFIG-CUSTOM-MIN-RTT-NOM-IDX.LMC3.N0 = "0x1";
	DDR-CONFIG-CUSTOM-MIN-RTT-NOM-IDX.LMC2.N0 = "0x1";
	DDR-CONFIG-CUSTOM-MIN-RTT-NOM-IDX.LMC1.N0 = "0x1";
	DDR-CONFIG-CUSTOM-MIN-RTT-NOM-IDX.LMC0.N0 = "0x1";

	/* 1=120ohms, 2=60ohms, 3=40ohms, 4=30ohms, 5=20ohms
	Parameters:
	    LMC#: Parameter can be different for memory controller. This
	        specifies which LMC the value is for. LMC must be
	        0-3. Optional.
	    N#: Parameter can be different for each node. This specifies
	        which node the value is for. Node must be 0-3. Optional. */
	//DDR-CONFIG-CUSTOM-MAX-RTT-NOM-IDX.LMC%d.N%d = "5";
	DDR-CONFIG-CUSTOM-MAX-RTT-NOM-IDX.LMC3.N0 = "0x7";
	DDR-CONFIG-CUSTOM-MAX-RTT-NOM-IDX.LMC2.N0 = "0x7";
	DDR-CONFIG-CUSTOM-MAX-RTT-NOM-IDX.LMC1.N0 = "0x7";
	DDR-CONFIG-CUSTOM-MAX-RTT-NOM-IDX.LMC0.N0 = "0x7";

	/* 1=20ohms, 2=30ohms, 3=40ohms, 4=60ohms, 5=120ohms
	Parameters:
	    LMC#: Parameter can be different for memory controller. This
	        specifies which LMC the value is for. LMC must be
	        0-3. Optional.
	    N#: Parameter can be different for each node. This specifies
	        which node the value is for. Node must be 0-3. Optional. */
	//DDR-CONFIG-CUSTOM-MIN-RODT-CTL.LMC%d.N%d = "1";
	DDR-CONFIG-CUSTOM-MIN-RODT-CTL.LMC3.N0 = "0x1";
	DDR-CONFIG-CUSTOM-MIN-RODT-CTL.LMC2.N0 = "0x1";
	DDR-CONFIG-CUSTOM-MIN-RODT-CTL.LMC1.N0 = "0x1";
	DDR-CONFIG-CUSTOM-MIN-RODT-CTL.LMC0.N0 = "0x1";

	/* 1=20ohms, 2=30ohms, 3=40ohms, 4=60ohms, 5=120ohms
	Parameters:
	    LMC#: Parameter can be different for memory controller. This
	        specifies which LMC the value is for. LMC must be
	        0-3. Optional.
	    N#: Parameter can be different for each node. This specifies
	        which node the value is for. Node must be 0-3. Optional. */
	//DDR-CONFIG-CUSTOM-MAX-RODT-CTL.LMC%d.N%d = "5";
	DDR-CONFIG-CUSTOM-MAX-RODT-CTL.LMC3.N0 = "0x7";
	DDR-CONFIG-CUSTOM-MAX-RODT-CTL.LMC2.N0 = "0x7";
	DDR-CONFIG-CUSTOM-MAX-RODT-CTL.LMC1.N0 = "0x7";
	DDR-CONFIG-CUSTOM-MAX-RODT-CTL.LMC0.N0 = "0x7";

	/* Drive strength control for DDR_CK_X_P, DDR_DIMMX_CSX_L,
	DDR_DIMMX_ODT_X drivers.
	Parameters:
	    LMC#: Parameter can be different for memory controller. This
	        specifies which LMC the value is for. LMC must be
	        0-3. Optional.
	    N#: Parameter can be different for each node. This specifies
	        which node the value is for. Node must be 0-3. Optional. */
	//DDR-CONFIG-CUSTOM-CK-CTL.LMC%d.N%d = "0";
	DDR-CONFIG-CUSTOM-CK-CTL.LMC3.N0 = "0x4";
	DDR-CONFIG-CUSTOM-CK-CTL.LMC2.N0 = "0x4";
	DDR-CONFIG-CUSTOM-CK-CTL.LMC1.N0 = "0x4";
	DDR-CONFIG-CUSTOM-CK-CTL.LMC0.N0 = "0x4";

	/* Drive strength control for CMD/A/RESET_L/CKEX drivers.
	Parameters:
	    LMC#: Parameter can be different for memory controller. This
	        specifies which LMC the value is for. LMC must be
	        0-3. Optional.
	    N#: Parameter can be different for each node. This specifies
	        which node the value is for. Node must be 0-3. Optional. */
	//DDR-CONFIG-CUSTOM-CMD-CTL.LMC%d.N%d = "0";
	DDR-CONFIG-CUSTOM-CMD-CTL.LMC3.N0 = "0x4";
	DDR-CONFIG-CUSTOM-CMD-CTL.LMC2.N0 = "0x4";
	DDR-CONFIG-CUSTOM-CMD-CTL.LMC1.N0 = "0x4";
	DDR-CONFIG-CUSTOM-CMD-CTL.LMC0.N0 = "0x4";

	/* Drive strength control for ODT, etc. drivers.
	In DDR3 mode:
	    0x1 = 24 ohm.
	    0x2 = 26.67 ohm.
	    0x3 = 30 ohm.
	    0x4 = 34.3 ohm.
	    0x5 = 40 ohm.
	    0x6 = 48 ohm.
	    0x7 = 60 ohm.
	    else = Reserved.
	In DDR4 mode:
	    0x0 = Reserved.
	    0x1 = Reserved.
	    0x2 = 26 ohm.
	    0x3 = 30 ohm.
	    0x4 = 34 ohm.
	    0x5 = 40 ohm.
	    0x6 = 48 ohm.
	    else = Reserved.
	Parameters:
	    LMC#: Parameter can be different for memory controller. This
	        specifies which LMC the value is for. LMC must be
	        0-3. Optional.
	    N#: Parameter can be different for each node. This specifies
	        which node the value is for. Node must be 0-3. Optional. */
	//DDR-CONFIG-CUSTOM-CTL-CTL.LMC%d.N%d = "0";
	DDR-CONFIG-CUSTOM-CTL-CTL.LMC3.N0 = "0x4";
	DDR-CONFIG-CUSTOM-CTL-CTL.LMC2.N0 = "0x4";
	DDR-CONFIG-CUSTOM-CTL-CTL.LMC1.N0 = "0x4";
	DDR-CONFIG-CUSTOM-CTL-CTL.LMC0.N0 = "0x4";

	/* Minimum allowed CAS Latency
	Parameters:
	    LMC#: Parameter can be different for memory controller. This
	        specifies which LMC the value is for. LMC must be
	        0-3. Optional.
	    N#: Parameter can be different for each node. This specifies
	        which node the value is for. Node must be 0-3. Optional. */
	//DDR-CONFIG-CUSTOM-MIN-CAS-LATENCY.LMC%d.N%d = "0";

	/* When set, LMC attempts to select the read-leveling setting that is
	LMC()_RLEVEL_CTL[OFFSET] settings earlier than the last passing
	read-leveling setting in the largest contiguous sequence of
	passing settings. When clear, or if the setting selected by
	LMC()_RLEVEL_CTL[OFFSET] did not pass, LMC selects the middle
	setting in the largest contiguous sequence of passing settings,
	rounding earlier when necessary.
	Parameters:
	    LMC#: Parameter can be different for memory controller. This
	        specifies which LMC the value is for. LMC must be
	        0-3. Optional.
	    N#: Parameter can be different for each node. This specifies
	        which node the value is for. Node must be 0-3. Optional. */
	//DDR-CONFIG-CUSTOM-OFFSET-EN.LMC%d.N%d = "1";
	DDR-CONFIG-CUSTOM-OFFSET-EN.LMC3.N0 = "0x1";
	DDR-CONFIG-CUSTOM-OFFSET-EN.LMC2.N0 = "0x1";
	DDR-CONFIG-CUSTOM-OFFSET-EN.LMC1.N0 = "0x1";
	DDR-CONFIG-CUSTOM-OFFSET-EN.LMC0.N0 = "0x1";

	/* The offset used when LMC()_RLEVEL_CTL[OFFSET] is set.
	Parameters:
	   %s: This setting can by specified by DRAM type (UDIMM or RDIMM)
	       Different settings can be used for each, or the type can be
	       omitted to use the same setting for both.
	    LMC#: Parameter can be different for memory controller. This
	        specifies which LMC the value is for. LMC must be
	        0-3. Optional.
	    N#: Parameter can be different for each node. This specifies
	        which node the value is for. Node must be 0-3. Optional. */
	//DDR-CONFIG-CUSTOM-OFFSET.%s.LMC%d.N%d = "0";
	DDR-CONFIG-CUSTOM-OFFSET.RDIMM.LMC3.N0 = "0x2";
	DDR-CONFIG-CUSTOM-OFFSET.UDIMM.LMC3.N0 = "0x2";
	DDR-CONFIG-CUSTOM-OFFSET.RDIMM.LMC2.N0 = "0x2";
	DDR-CONFIG-CUSTOM-OFFSET.UDIMM.LMC2.N0 = "0x2";
	DDR-CONFIG-CUSTOM-OFFSET.RDIMM.LMC1.N0 = "0x2";
	DDR-CONFIG-CUSTOM-OFFSET.UDIMM.LMC1.N0 = "0x2";
	DDR-CONFIG-CUSTOM-OFFSET.RDIMM.LMC0.N0 = "0x2";
	DDR-CONFIG-CUSTOM-OFFSET.UDIMM.LMC0.N0 = "0x2";

	/* Enables software interpretation of per-byte read delays using the
	measurements collected by the chip rather than completely relying
	on the automatically to determine the delays. 1=software
	computation is recommended since a more complete analysis is
	implemented in software.
	Parameters:
	    LMC#: Parameter can be different for memory controller. This
	        specifies which LMC the value is for. LMC must be
	        0-3. Optional.
	    N#: Parameter can be different for each node. This specifies
	        which node the value is for. Node must be 0-3. Optional. */
	//DDR-CONFIG-CUSTOM-RLEVEL-COMPUTE.LMC%d.N%d = "0";

	/* 1 means automatically set RTT_NOM value.
	Parameters:
	    LMC#: Parameter can be different for memory controller. This
	        specifies which LMC the value is for. LMC must be
	        0-3. Optional.
	    N#: Parameter can be different for each node. This specifies
	        which node the value is for. Node must be 0-3. Optional. */
	//DDR-CONFIG-CUSTOM-DDR-RTT-NOM-AUTO.LMC%d.N%d = "0";

	/* 1 means automatically set RODT_CTL value.
	Parameters:
	    LMC#: Parameter can be different for memory controller. This
	        specifies which LMC the value is for. LMC must be
	        0-3. Optional.
	    N#: Parameter can be different for each node. This specifies
	        which node the value is for. Node must be 0-3. Optional. */
	//DDR-CONFIG-CUSTOM-DDR-RODT-CTL-AUTO.LMC%d.N%d = "0";

	/* Set to 2 unless instructed differently by Cavium.
	Parameters:
	    LMC#: Parameter can be different for memory controller. This
	        specifies which LMC the value is for. LMC must be
	        0-3. Optional.
	    N#: Parameter can be different for each node. This specifies
	        which node the value is for. Node must be 0-3. Optional. */
	//DDR-CONFIG-CUSTOM-RLEVEL-COMP-OFFSET.%s.LMC%d.N%d = "2";

	/* Determines the number of times the read-leveling sequence is run
	for each rank. The results is then averaged across the number of
	loops. The default setting is 1.
	Parameters:
	    LMC#: Parameter can be different for memory controller. This
	        specifies which LMC the value is for. LMC must be
	        0-3. Optional.
	    N#: Parameter can be different for each node. This specifies
	        which node the value is for. Node must be 0-3. Optional. */
	//DDR-CONFIG-CUSTOM-RLEVEL-AVERAGE-LOOPS.LMC%d.N%d = "0";

	/* Turn on the DDR 2T mode. 2-cycle window for CMD and address. This
	mode helps relieve setup time pressure on the address and command
	bus. Please refer to Micron's tech note tn_47_01 titled DDR2-533
	Memory Design Guide for Two DIMM Unbuffered Systems for physical
	details.
	Parameters:
	   %s: This setting can by specified by DRAM type (UDIMM or RDIMM)
	       Different settings can be used for each, or the type can be
	       omitted to use the same setting for both.
	    LMC#: Parameter can be different for memory controller. This
	        specifies which LMC the value is for. LMC must be
	        0-3. Optional.
	    N#: Parameter can be different for each node. This specifies
	        which node the value is for. Node must be 0-3. Optional. */
	//DDR-CONFIG-CUSTOM-DDR2T.%s.LMC%d.N%d = "0";
	DDR-CONFIG-CUSTOM-DDR2T.RDIMM.LMC3.N0 = "0x1";
	DDR-CONFIG-CUSTOM-DDR2T.UDIMM.LMC3.N0 = "0x1";
	DDR-CONFIG-CUSTOM-DDR2T.RDIMM.LMC2.N0 = "0x1";
	DDR-CONFIG-CUSTOM-DDR2T.UDIMM.LMC2.N0 = "0x1";
	DDR-CONFIG-CUSTOM-DDR2T.RDIMM.LMC1.N0 = "0x1";
	DDR-CONFIG-CUSTOM-DDR2T.UDIMM.LMC1.N0 = "0x1";
	DDR-CONFIG-CUSTOM-DDR2T.RDIMM.LMC0.N0 = "0x1";
	DDR-CONFIG-CUSTOM-DDR2T.UDIMM.LMC0.N0 = "0x1";

	/* As result of the flyby topology prescribed in the JEDEC
	specifications the byte delays should maintain a consistent
	increasing or decreasing trend across the bytes on standard DIMMs.
	This setting can be used disable that check for unusual
	circumstances where the check is not useful.
	Parameters:
	    LMC#: Parameter can be different for memory controller. This
	        specifies which LMC the value is for. LMC must be
	        0-3. Optional.
	    N#: Parameter can be different for each node. This specifies
	        which node the value is for. Node must be 0-3. Optional. */
	//DDR-CONFIG-CUSTOM-DISABLE-SEQUENTIAL-DELAY-CHECK.LMC%d.N%d = "0";

	/* An additional sequential delay check for the delays that result
	from the flyby topology. This value specifies the maximum
	difference between the delays of adjacent bytes.  A value of 0
	disables this check.
	Parameters:
	    LMC#: Parameter can be different for memory controller. This
	        specifies which LMC the value is for. LMC must be
	        0-3. Optional.
	    N#: Parameter can be different for each node. This specifies
	        which node the value is for. Node must be 0-3. Optional. */
	//DDR-CONFIG-CUSTOM-MAXIMUM-ADJACENT-RLEVEL-DELAY-INCREMENT.LMC%d.N%d = "0";
	DDR-CONFIG-CUSTOM-MAXIMUM-ADJACENT-RLEVEL-DELAY-INCREMENT.LMC3 = "0x2";
	DDR-CONFIG-CUSTOM-MAXIMUM-ADJACENT-RLEVEL-DELAY-INCREMENT.LMC2 = "0x2";
	DDR-CONFIG-CUSTOM-MAXIMUM-ADJACENT-RLEVEL-DELAY-INCREMENT.LMC1 = "0x2";
	DDR-CONFIG-CUSTOM-MAXIMUM-ADJACENT-RLEVEL-DELAY-INCREMENT.LMC0 = "0x2";

	/* The parity input signal PAR_IN on each DIMM must be strapped high
	or low on the board.  This bit is programmed into
	LMC0_DIMM_CTL[PARITY] and it must be set to match the board
	strapping.  This signal is typically strapped low.
	Parameters:
	    LMC#: Parameter can be different for memory controller. This
	        specifies which LMC the value is for. LMC must be
	        0-3. Optional.
	    N#: Parameter can be different for each node. This specifies
	        which node the value is for. Node must be 0-3. Optional. */
	//DDR-CONFIG-CUSTOM-PARITY.LMC%d.N%d = "0";

	/* Front Porch Enable: When set, the turn-off time for the default
	DDR_DQ/DQS drivers is FPRCH2 CKs earlier.
	    0 = 0 CKs
	    1 = 1 CKs
	    2 = 2 CKs
	Parameters:
	    LMC#: Parameter can be different for memory controller. This
	        specifies which LMC the value is for. LMC must be
	        0-3. Optional.
	    N#: Parameter can be different for each node. This specifies
	        which node the value is for. Node must be 0-3. Optional. */
	//DDR-CONFIG-CUSTOM-FPRCH2.LMC%d.N%d = "0";
	DDR-CONFIG-CUSTOM-FPRCH2.LMC3.N0 = "0x2";
	DDR-CONFIG-CUSTOM-FPRCH2.LMC2.N0 = "0x2";
	DDR-CONFIG-CUSTOM-FPRCH2.LMC1.N0 = "0x2";
	DDR-CONFIG-CUSTOM-FPRCH2.LMC0.N0 = "0x2";

	/* Enable 32-bit datapath mode. Set to 1 if only 32 DQ pins are
	used.
	Parameters:
	    LMC#: Parameter can be different for memory controller. This
	        specifies which LMC the value is for. LMC must be
	        0-3. Optional.
	    N#: Parameter can be different for each node. This specifies
	        which node the value is for. Node must be 0-3. Optional. */
	//DDR-CONFIG-CUSTOM-MODE32B.LMC%d.N%d = "0";

	/* Use Measured VREF
	Parameters:
	    LMC#: Parameter can be different for memory controller. This
	        specifies which LMC the value is for. LMC must be
	        0-3. Optional.
	    N#: Parameter can be different for each node. This specifies
	        which node the value is for. Node must be 0-3. Optional. */
	//DDR-CONFIG-CUSTOM-MEASURED-VREF.LMC%d.N%d = "0";

	/* Supply a custom DLL write offset
	Parameters:
	    BYTE#: Byte lane to apply the parameter to (0-8).
	    LMC#: Parameter can be different for memory controller. This
	        specifies which LMC the value is for. LMC must be
	        0-3. Optional.
	    N#: Parameter can be different for each node. This specifies
	        which node the value is for. Node must be 0-3. Optional. */
	//DDR-CONFIG-CUSTOM-DLL-WRITE-OFFSET.BYTE%d.LMC%d.N%d = "0";

	/* Supply a custom DLL read offset
	Parameters:
	    BYTE#: Byte lane to apply the parameter to (0-8).
	    LMC#: Parameter can be different for memory controller. This
	        specifies which LMC the value is for. LMC must be
	        0-3. Optional.
	    N#: Parameter can be different for each node. This specifies
	        which node the value is for. Node must be 0-3. Optional. */
	//DDR-CONFIG-CUSTOM-DLL-READ-OFFSET.BYTE%d.LMC%d.N%d = "0";

	/* Specify the debug logging level during DRAM initialization. Zero
	disables debug logging. The possible debug levels are:
	    0: Off, no logging
	    1: Logging of initialization at a normal detail level
	    2: Trace each initialization sequence
	    3: Trace every DRAM controller register write */
	//DDR-VERBOSE = "0";

	/* Run a short DRAM test after DRAM is initialized as quick check
	for functionality. This is normally not needed required. Boards
	with poor DRAM power supplies may use this to detect failures
	during boot. This should be used in combination with the watchdog
	timer. */
	//DDR-TEST-BOOT = "0";

	/* The DRAM initialization code has the ability to toggle a GPIO to
	signal when it is running. Boards may need to mux TWSI access
	between a BMC and THUNDERX so the BMC can monitor DIMM temperatures
	and health. This GPIO will be driven high when THUNDERX may read
	from the SPDs on the DIMMs. When driven low, another device (BMC)
	may takeover the TWSI connections to the DIMMS. The default value
	(-1) disables this feature. */
	//DDR-CONFIG-GPIO = "-1";

	/* Specify a THUNDERX GPIO used to control power for a USB port. When
	set, the USB host controller will toggle the GPIO automatically
	during USB reset events. The default value assumes THUNDERX has no
	control of the USB power and it is always on. */
	//USB-PWR-GPIO.N%d.PORT%d = "-1";

	/* Number of reading with no errors to signal the start of an
	eye. The default value should be good for most cases. */
	//QLM-EYE-NUM-ZEROS = "2";

	/* Time to sample at each location in microseconds. The default
	value should be good for most cases. */
	//QLM-EYE-SAMPLE-TIME = "0x190";

	/* Time to settle after each movement in microseconds. The
	default value should be good for most cases. */
	//QLM-EYE-SETTLE-TIME = "0x32";
}; /* cavium,bdk */
}; /* / */
